define exported symbol __vectors_table = 0x0;
define exported symbol Reset_Handler = 0x101;
define exported symbol NMI_Handler = 0x105;
define exported symbol HardFault_Handler = 0x109;
define exported symbol MemManage_Handler = 0x10d;
define exported symbol BusFault_Handler = 0x111;
define exported symbol DiagVSprintf = 0x115;
define exported symbol DiagPrintf = 0x475;
define exported symbol DiagPrintfD = 0x4b9;
define exported symbol DiagSPrintf = 0x4dd;
define exported symbol DiagSnPrintf = 0x501;
define exported symbol cmd_write_word = 0x8d9;
define exported symbol cmd_dump_word = 0x91d;
define exported symbol cmd_flash = 0x9f9;
define exported symbol cmd_efuse = 0xf91;
define exported symbol cmd_rom_table = 0x12e9;
define exported symbol Rand = 0x12f5;
define exported symbol Rand_Arc4 = 0x1375;
define exported symbol RandBytes_Get = 0x13a9;
define exported symbol io_assert_failed = 0x13f1;
define exported symbol BKUP_Write = 0x1411;
define exported symbol BKUP_Read = 0x1435;
define exported symbol BKUP_Set = 0x1455;
define exported symbol BKUP_Clear = 0x147d;
define exported symbol BOOT_Reason = 0x14a5;
define exported symbol DelayNop = 0x14b5;
define exported symbol DelayUs = 0x14c3;
define exported symbol DelayMs = 0x1505;
define exported symbol EFUSEPowerSwitch = 0x1519;
define exported symbol EFUSERead8 = 0x159d;
define exported symbol EFUSEWrite8 = 0x1661;
define exported symbol EFUSE_PG_Packet = 0x1731;
define exported symbol EFUSE_LogicalMap_Read = 0x1965;
define exported symbol EFUSE_LogicalMap_Write = 0x1a71;
define exported symbol FLASH_SW_CS_Control = 0x1c51;
define exported symbol FLASH_SetSpiMode = 0x1c91;
define exported symbol FLASH_RxCmd = 0x1d1d;
define exported symbol FLASH_WaitBusy = 0x1d89;
define exported symbol FLASH_RxData = 0x1df5;
define exported symbol FLASH_TxCmd = 0x1ebd;
define exported symbol FLASH_WriteEn = 0x1f3d;
define exported symbol FLASH_TxData256B = 0x1f61;
define exported symbol FLASH_TxData12B = 0x2049;
define exported symbol FLASH_SetStatus = 0x2129;
define exported symbol FLASH_Erase = 0x2147;
define exported symbol FLASH_DeepPowerDown = 0x21b9;
define exported symbol FLASH_SetStatusBits = 0x2205;
define exported symbol FLASH_StructInit_Micron = 0x22a5;
define exported symbol FLASH_StructInit_MXIC = 0x2333;
define exported symbol FLASH_StructInit_GD = 0x23bd;
define exported symbol FLASH_StructInit = 0x2451;
define exported symbol FLASH_Init = 0x24e1;
define exported symbol GDMA_StructInit = 0x2559;
define exported symbol GDMA_SetLLP = 0x2579;
define exported symbol GDMA_ClearINTPendingBit = 0x25e1;
define exported symbol GDMA_ClearINT = 0x26ad;
define exported symbol GDMA_INTConfig = 0x2775;
define exported symbol GDMA_Cmd = 0x286d;
define exported symbol GDMA_Init = 0x28b9;
define exported symbol GDMA_ChCleanAutoReload = 0x29e5;
define exported symbol GDMA_SetSrcAddr = 0x2a41;
define exported symbol GDMA_GetSrcAddr = 0x2a75;
define exported symbol GDMA_GetDstAddr = 0x2aa5;
define exported symbol GDMA_SetDstAddr = 0x2ad9;
define exported symbol GDMA_SetBlkSize = 0x2b0d;
define exported symbol GDMA_GetBlkSize = 0x2b4d;
define exported symbol GDMA_ChnlRegister = 0x2b85;
define exported symbol GDMA_ChnlUnRegister = 0x2bc9;
define exported symbol GDMA_ChnlAlloc = 0x2c01;
define exported symbol GDMA_ChnlFree = 0x2c85;
define exported symbol GDMA_GetIrqNum = 0x2ce5;
define exported symbol GPIO_INTMode = 0x2d15;
define exported symbol GPIO_INTConfig = 0x2da1;
define exported symbol GPIO_INTHandler = 0x2dcd;
define exported symbol GPIO_Direction = 0x2e71;
define exported symbol GPIO_Init = 0x2e9d;
define exported symbol GPIO_DeInit = 0x2f19;
define exported symbol GPIO_ReadDataBit = 0x2f7d;
define exported symbol GPIO_WriteBit = 0x2f9d;
define exported symbol GPIO_PortDirection = 0x2fc9;
define exported symbol GPIO_PortRead = 0x2fed;
define exported symbol GPIO_PortWrite = 0x2ffd;
define exported symbol GPIO_UserRegIrq = 0x3015;
define exported symbol IPC_INTConfig = 0x3045;
define exported symbol IPC_IERSet = 0x3057;
define exported symbol IPC_IERGet = 0x305b;
define exported symbol IPC_INTRequest = 0x305f;
define exported symbol IPC_INTClear = 0x3067;
define exported symbol IPC_INTGet = 0x306f;
define exported symbol IPC_CPUID = 0x3073;
define exported symbol IPC_SEMGet = 0x307d;
define exported symbol IPC_SEMFree = 0x30c5;
define exported symbol IPC_INTHandler = 0x3129;
define exported symbol IPC_INTUserHandler = 0x3161;
define exported symbol LOGUART_StructInit = 0x3199;
define exported symbol LOGUART_Init = 0x31b1;
define exported symbol LOGUART_PutChar = 0x31f1;
define exported symbol LOGUART_GetChar = 0x3221;
define exported symbol LOGUART_Readable = 0x3239;
define exported symbol LOGUART_GetIMR = 0x324d;
define exported symbol LOGUART_SetIMR = 0x3259;
define exported symbol LOGUART_WaitBusy = 0x3265;
define exported symbol LOGUART_SetBaud = 0x3285;
define exported symbol LOGUART_SetBaud_FromFlash = 0x32c9;
define exported symbol LOGUART_DiagInit = 0x32e9;
define exported symbol mpu_enable = 0x3359;
define exported symbol mpu_disable = 0x3371;
define exported symbol mpu_init = 0x3385;
define exported symbol mpu_set_mem_attr = 0x33ad;
define exported symbol mpu_region_cfg = 0x3401;
define exported symbol mpu_entry_free = 0x34ed;
define exported symbol mpu_entry_alloc = 0x34f9;
define exported symbol RSIP_Cmd = 0x3511;
define exported symbol RSIP_OTF_init = 0x3531;
define exported symbol RSIP_OTF_Cmd = 0x3595;
define exported symbol RSIP_OTF_Mask = 0x35a9;
define exported symbol RSIP_KEY_Request = 0x35e9;
define exported symbol RSIP_MMU_Config = 0x3625;
define exported symbol RSIP_MMU_Cmd = 0x3649;
define exported symbol PAD_PullCtrl = 0x3685;
define exported symbol PAD_CMD = 0x36b1;
define exported symbol Pinmux_Config = 0x36dd;
define exported symbol Pinmux_ConfigGet = 0x36fd;
define exported symbol Pinmux_UartLogCtrl = 0x370d;
define exported symbol Pinmux_SpicCtrl = 0x3749;
define exported symbol simulation_bit_index = 0x3801;
define exported symbol simulation_stage_set = 0x3815;
define exported symbol SYSTIMER_Init = 0x3839;
define exported symbol SYSTIMER_TickGet = 0x3885;
define exported symbol SYSTIMER_GetPassTime = 0x3899;
define exported symbol RTIM_TimeBaseStructInit = 0x38c5;
define exported symbol RTIM_Cmd = 0x38db;
define exported symbol RTIM_GetCount = 0x398d;
define exported symbol RTIM_INTConfig = 0x3a21;
define exported symbol RTIM_INTClear = 0x3ad1;
define exported symbol RTIM_TimeBaseInit = 0x3b65;
define exported symbol RTIM_DeInit = 0x3cad;
define exported symbol RTIM_INTClearPendingBit = 0x3d51;
define exported symbol RTIM_GetFlagStatus = 0x3ded;
define exported symbol RTIM_GetINTStatus = 0x3f0d;
define exported symbol UART_DeInit = 0x4039;
define exported symbol UART_StructInit = 0x403f;
define exported symbol UART_BaudParaGetFull = 0x405b;
define exported symbol UART_BaudParaGet = 0x408d;
define exported symbol UART_SetBaud = 0x40b1;
define exported symbol UART_SetBaudExt = 0x4141;
define exported symbol UART_SetRxLevel = 0x41b5;
define exported symbol UART_RxCmd = 0x41dd;
define exported symbol UART_Writable = 0x41ed;
define exported symbol UART_Readable = 0x41f5;
define exported symbol UART_CharPut = 0x41fd;
define exported symbol UART_CharGet = 0x4201;
define exported symbol UART_ReceiveData = 0x4207;
define exported symbol UART_SendData = 0x422d;
define exported symbol UART_ReceiveDataTO = 0x4251;
define exported symbol UART_SendDataTO = 0x4289;
define exported symbol UART_RxByteCntClear = 0x42c1;
define exported symbol UART_RxByteCntGet = 0x42cd;
define exported symbol UART_BreakCtl = 0x42d3;
define exported symbol UART_ClearRxFifo = 0x42e7;
define exported symbol UART_Init = 0x4307;
define exported symbol UART_ClearTxFifo = 0x43ad;
define exported symbol UART_INTConfig = 0x43b7;
define exported symbol UART_IntStatus = 0x43c9;
define exported symbol UART_ModemStatusGet = 0x43cd;
define exported symbol UART_LineStatusGet = 0x43d1;
define exported symbol UART_WaitBusy = 0x43d5;
define exported symbol BOOT_ROM_CM4PON = 0x43f9;
define exported symbol BOOT_ROM_OSC131_Enable = 0x44f1;
define exported symbol BOOT_ROM_ResetVsr = 0x4505;
define exported symbol EXT32K_Cmd = 0x49d1;
define exported symbol XTAL_ClkGet = 0x49f9;
define exported symbol CPU_ClkSet = 0x4a11;
define exported symbol CPU_ClkGet = 0x4a25;
define exported symbol FLASH_ClockDiv = 0x4a49;
define exported symbol FLASH_CalibrationInit = 0x4ae5;
define exported symbol FLASH_Calibration500MPSCmd = 0x4afd;
define exported symbol FLASH_CalibrationPhase = 0x4b1d;
define exported symbol FLASH_CalibrationPhaseIdx = 0x4ba9;
define exported symbol FLASH_CalibrationNewCmd = 0x4bc1;
define exported symbol FLASH_CalibrationNew = 0x4bfd;
define exported symbol FLASH_Calibration = 0x4dd1;
define exported symbol RCC_PeriphClockCmd = 0x4f09;
define exported symbol RCC_PeriphClockSource_RTC = 0x4f89;
define exported symbol RCC_PeriphClockSource_I2C = 0x4fd9;
define exported symbol RCC_PeriphClockSource_QDEC = 0x4ff9;
define exported symbol RCC_PeriphClockSource_UART = 0x5019;
define exported symbol SYSCFG_GetChipInfo = 0x5091;
define exported symbol SYSCFG_AutoLoadDone = 0x50ad;
define exported symbol SYSCFG_TRP_LDOMode = 0x50bd;
define exported symbol SYSCFG_TRP_UARTImage = 0x50cd;
define exported symbol SYSCFG_TRP_ICFG = 0x50dd;
define exported symbol SYSCFG_ROMINFO_Get = 0x50e9;
define exported symbol SYSCFG_ROMINFO_Set = 0x50f5;
define exported symbol INT_HardFault_C = 0x5299;
define exported symbol INT_NMI = 0x536d;
define exported symbol INT_HardFault = 0x5389;
define exported symbol INT_MemManage = 0x53a1;
define exported symbol INT_BusFault = 0x53bd;
define exported symbol INT_UsageFault = 0x53d9;
define exported symbol irq_table_init = 0x53f5;
define exported symbol irq_enable = 0x5559;
define exported symbol irq_disable = 0x5575;
define exported symbol irq_set_priority = 0x5599;
define exported symbol irq_get_priority = 0x55f9;
define exported symbol irq_set_pending = 0x563d;
define exported symbol irq_get_pending = 0x5659;
define exported symbol irq_clear_pending = 0x567d;
define exported symbol irq_register = 0x5699;
define exported symbol irq_unregister = 0x5711;
define exported symbol shell_array_init = 0x572d;
define exported symbol shell_get_argc = 0x573b;
define exported symbol shell_get_argv = 0x5767;
define exported symbol shell_cmd_chk = 0x5831;
define exported symbol shell_uart_irq_rom = 0x58f5;
define exported symbol shell_init_rom = 0x59ad;
define exported symbol shell_task_rom = 0x5a1d;
define exported symbol shell_rom = 0x5a45;
define exported symbol xmodem_img_rxbuffer = 0x5ae9;
define exported symbol xmodem_uart_init = 0x60f5;
define exported symbol xmodem_uart_deinit = 0x618d;
define exported symbol xmodem_uart_port_init = 0x61a1;
define exported symbol xmodem_uart_port_deinit = 0x61d5;
define exported symbol xmodem_uart_readable = 0x6221;
define exported symbol xmodem_uart_writable = 0x6239;
define exported symbol xmodem_uart_getc = 0x6251;
define exported symbol xmodem_uart_putc = 0x6275;
define exported symbol xmodem_uart_putdata = 0x628d;
define exported symbol xmodem_uart_getc_to = 0x62a9;
define exported symbol xmodem_uart_clean_rx = 0x62f1;
define exported symbol xmodem_img_write = 0x6331;
define exported symbol xmodem_img_download = 0x634d;
define exported symbol _char2num = 0x63c1;
define exported symbol _2char2dec = 0x63ed;
define exported symbol _2char2hex = 0x645d;
define exported symbol _memchr = 0x64c5;
define exported symbol _memcmp = 0x6545;
define exported symbol _memcpy = 0x6591;
define exported symbol _memmove = 0x6611;
define exported symbol _memset = 0x66ad;
define exported symbol _vsscanf = 0x67d1;
define exported symbol _sscanf = 0x6c51;
define exported symbol _stratoi = 0x6c69;
define exported symbol _strcat = 0x6cc1;
define exported symbol _strchr = 0x6d11;
define exported symbol _strcmp = 0x6de9;
define exported symbol _strcpy = 0x6e49;
define exported symbol _stricmp = 0x6e91;
define exported symbol _strlen = 0x6ec5;
define exported symbol _strncat = 0x6f29;
define exported symbol _strncmp = 0x6f8d;
define exported symbol _strncpy = 0x7019;
define exported symbol _strnlen = 0x7081;
define exported symbol _strpbrk = 0x70a5;
define exported symbol _strsep = 0x70d1;
define exported symbol _strstr = 0x73cd;
define exported symbol _strtoull = 0x75d5;
define exported symbol _strtoll = 0x76d5;
define exported symbol _strtok = 0x76f5;
define exported symbol __strtok_r = 0x7705;
define exported symbol _strtok_r = 0x7761;
define exported symbol _strtol_r = 0x776d;
define exported symbol _strtol = 0x7899;
define exported symbol _strtoul_r = 0x78a1;
define exported symbol _strtoul = 0x79d9;
define exported symbol _strupr = 0x79e1;
define exported symbol Write778_8721D_ROM = 0x79fd;
define exported symbol DacSwing_8721D_ROM = 0x7a3d;
define exported symbol InitBTMailbox_8721D_ROM = 0x7a61;
define exported symbol BTMailboxRetry_8721D_ROM = 0x7ae9;
define exported symbol C2HBTInfo_8721D_ROM = 0x7b39;
define exported symbol C2HBTLoopback_8721D_ROM = 0x7be5;
define exported symbol C2HBTMpRpt_8721D_ROM = 0x7c21;
define exported symbol BTNullSetting_8721D_ROM = 0x7c91;
define exported symbol IssueBTQNull_8721D_ROM = 0x7cf9;
define exported symbol WlanActCtrl_8721D_ROM = 0x7d9d;
define exported symbol ChangeCoexTable_8721D_ROM = 0x7dd5;
define exported symbol InitBTCoexTimer_8721D_ROM = 0x7e15;
define exported symbol FlexibleExtensionDecision_8721D_ROM = 0x7e31;
define exported symbol BT_TDMA_Slot_Operation_1and4_8721D_ROM = 0x7f95;
define exported symbol BT_TDMA_Slot_Operation_2and5_8721D_ROM = 0x80c9;
define exported symbol BT_TDMA_Slot_Operation_0and3_8721D_ROM = 0x81fd;
define exported symbol InitBTypeTDMA2_8721D_ROM = 0x8341;
define exported symbol BTypeTDMABCNEarly_8721D_ROM = 0x8361;
define exported symbol BTypeTDMATBTThdl_8721D_ROM = 0x8445;
define exported symbol BTypeTDMATimeOuthdl_8721D_ROM = 0x8491;
define exported symbol BTRoleChangeTimerHDL_8721D_ROM = 0x84e9;
define exported symbol BTRoleChangeTBTTHDL_8721D_ROM = 0x8509;
define exported symbol MailboxINTHDL_8721D_ROM = 0x8559;
define exported symbol H2CInQueue_8721D_ROM = 0x8701;
define exported symbol H2CDeQueue_8721D_ROM = 0x87fd;
define exported symbol InitC2H_8721D_ROM = 0x8855;
define exported symbol WaitC2HOk_8721D_ROM = 0x8879;
define exported symbol C2HPKTRxDESC_8721D_ROM = 0x88b5;
define exported symbol FillC2HContant_8721D_ROM = 0x890d;
define exported symbol IssueC2HPKT_8721D_ROM = 0x8949;
define exported symbol C2HDeQueue_8721D_ROM = 0x8999;
define exported symbol C2HInQueue_8721D_ROM = 0x89e9;
define exported symbol PktBufAccessCtrl_8721D_ROM = 0x8a3d;
define exported symbol FillMailbox_8721D_ROM = 0x8aad;
define exported symbol WL2BTMailbox_8721D_ROM = 0x8b69;
define exported symbol H2CHDL_BTInfo_8721D_ROM = 0x8bfd;
define exported symbol H2CHDL_ForceBTTxpwr_8721D_ROM = 0x8c81;
define exported symbol H2CHDL_BTIgnoreWlanAct_8721D_ROM = 0x8c95;
define exported symbol H2CHDL_DACSwingValue_8721D_ROM = 0x8d05;
define exported symbol H2CHDL_AntSelReverse_8721D_ROM = 0x8d41;
define exported symbol H2CHDL_WLOpmode_8721D_ROM = 0x8d55;
define exported symbol H2CHDL_BTMpH2C_8721D_ROM = 0x8dc5;
define exported symbol H2CHDL_BTControl_8721D_ROM = 0x8e7d;
define exported symbol H2CHDL_BTWifiCtrl_8721D_ROM = 0x8ee5;
define exported symbol H2CHDL_BT_Page_Scan_Interval_8721D_ROM = 0x8f8d;
define exported symbol H2CHDL_WLCalibration_8721D_ROM = 0x8fb1;
define exported symbol H2CHDL_GNT_BT_CTRL_8721D_ROM = 0x9021;
define exported symbol H2CHDL_BT_ONLY_TEST_8721D_ROM = 0x906d;
define exported symbol H2CHDL_BT_Init_Param_8721D_ROM = 0x9099;
define exported symbol CheckMaxMacidNum_8721D_ROM = 0x9119;
define exported symbol SetMediaStatus_8721D_ROM = 0x9169;
define exported symbol GetMediaStatus_8721D_ROM = 0x919d;
define exported symbol WaitDDMARDY = 0x91b5;
define exported symbol InitDDMA = 0x91e5;
define exported symbol ChkDDMAChksum = 0x92a5;
define exported symbol CheckDDMADone = 0x92e9;
define exported symbol FwlbkLLTWrite_8721D_ROM = 0x9311;
define exported symbol FwlbkCheckRxPayload_8721D_ROM = 0x935d;
define exported symbol FwlbkModeAFElbk_8721D_ROM = 0x95bd;
define exported symbol FwlbkMcuPollMgq_8721D_ROM = 0x972d;
define exported symbol FwlbkMode_8721D_ROM = 0x9789;
define exported symbol FwlbkHWInitialLLT_8721D_ROM = 0x9911;
define exported symbol FwlbkDbgPrtU16_8721D_ROM = 0x9981;
define exported symbol FwlbkPreparePkt_8721D_ROM = 0x998d;
define exported symbol FwlbkModeSel_8721D_ROM = 0x9a99;
define exported symbol FwlbkSetCAM_8721D_ROM = 0x9b31;
define exported symbol FwlbkUpdateParam_8721D_ROM = 0x9bd5;
define exported symbol FwlbkModeMaclbk_8721D_ROM = 0x9c21;
define exported symbol FwlbkModeTx_8721D_ROM = 0x9c31;
define exported symbol FwlbkModeTxNoCheck_8721D_ROM = 0x9c39;
define exported symbol FwlbkModeSecTest_8721D_ROM = 0x9c41;
define exported symbol OnWpa_offload_8721D_ROM = 0x9db9;
define exported symbol wpa_supplicant_process_1_of_2_8721D_ROM = 0x9f51;
define exported symbol wpa_supplicant_decrypt_key_data_8721D_ROM = 0x9f71;
define exported symbol wpa_supplicant_send_2_of_2_8721D_ROM = 0xa131;
define exported symbol WriteCAM_8721D_ROM = 0xa3bd;
define exported symbol ReadCAM_8721D_ROM = 0xa41d;
define exported symbol write_cam_wow_8721D_ROM = 0xa481;
define exported symbol AesTkipIvFun_8721D_ROM = 0xa531;
define exported symbol WepIvFun_8721D_ROM = 0xa581;
define exported symbol AppendTkipMIC_8721D_ROM = 0xa5bd;
define exported symbol RTmemcmpBackward_8721D_ROM = 0xa6a9;
define exported symbol AssignIvToKeyRsc_8721D_ROM = 0xa6cf;
define exported symbol AssignKeyRscToIV_8721D_ROM = 0xa6fd;
define exported symbol AesTkipIvCheck_8721D_ROM = 0xa73f;
define exported symbol WepIvCheck_8721D_ROM = 0xa7b1;
define exported symbol ReadGTKData_8721D_ROM = 0xa7ed;
define exported symbol ClrAllFWUsedIMR_8721D_ROM = 0xa811;
define exported symbol ClrAllFWUsedISR_8721D_ROM = 0xa875;
define exported symbol CheckFWLBKEnable_8721D_ROM = 0xa8d9;
define exported symbol UpdateISRWlan_8721D = 0xa8ed;
define exported symbol UpdateISRFT_8721D = 0xa9a5;
define exported symbol getSumValue_8721D_ROM = 0xaa01;
define exported symbol getCheckSum_8721D_ROM = 0xaa4d;
define exported symbol AESUnwrapSwap_8721D_ROM = 0xaadd;
define exported symbol FillParameterIpsec_8721D_ROM = 0xab2d;
define exported symbol FillMichaelPacketInfo_8721D_ROM = 0xab51;
define exported symbol AesUnwrapIpsec_8721D_ROM = 0xab79;
define exported symbol HmacSha1Ipsec_8721D_ROM = 0xabfd;
define exported symbol HmcMd5Ipsec_8721D_ROM = 0xac5d;
define exported symbol TkipMicIpsec_8721D_ROM = 0xacbd;
define exported symbol RC4Ipsec_8721D_ROM = 0xadcd;
define exported symbol IPSecDataIn_8721D_ROM = 0xae9d;
define exported symbol IPSecDataOut_8721D_ROM = 0xaeb1;
define exported symbol IPSecFillDesrciptor_8721D_ROM = 0xaec5;
define exported symbol IPSWriteDescriptorIO_8721D_ROM = 0xaeef;
define exported symbol IPSecDesrciptor_8721D_ROM = 0xaf09;
define exported symbol IPSecWriteDataIOMode_8721D_ROM = 0xaf1d;
define exported symbol IPSecSetExMemoryAddr_8721D_ROM = 0xaf85;
define exported symbol IPSecSetDescAddr_8721D_ROM = 0xaf99;
define exported symbol IPSecGetDataIOMode_8721D_ROM = 0xafad;
define exported symbol IPSecSetOPMode_8721D_ROM = 0xb009;
define exported symbol IPSecEngine_8721D_ROM = 0xb085;
define exported symbol Aes128EncIpsec_8721D_ROM = 0xb19d;
define exported symbol AESEncrypt128_8721D_ROM = 0xb1fd;
define exported symbol Aes128DecIpsec_8721D_ROM = 0xb24d;
define exported symbol AESDecrypt128_8721D_ROM = 0xb2ad;
define exported symbol AES_CMAC_GenerateSubKey_1W_8721D_ROM = 0xb2fd;
define exported symbol AES_CMAC_1W_8721D_ROM = 0xb3a1;
define exported symbol AES_KeyExpansion_1W_8721D_ROM = 0xb491;
define exported symbol AES_Encrypt_1W_8721D_ROM = 0xb595;
define exported symbol ChangeTransmiteRate_8721D_ROM = 0xb791;
define exported symbol PowerBitSetting_8721D_ROM = 0xb815;
define exported symbol IssuePSPoll_8721D_ROM = 0xb87d;
define exported symbol ChkandChangePS_8721D_ROM = 0xb8bd;
define exported symbol IssueQNull_8721D_ROM = 0xb94d;
define exported symbol CTS2SelfSetting_8721D_ROM = 0xb9e1;
define exported symbol IssueCTS2Self_8721D_ROM = 0xb9fd;
define exported symbol CheckCPUMGQEmpty_8721D_ROM = 0xba89;
define exported symbol IssueRsvdPagePacketSetting_8721D_ROM = 0xbac9;
define exported symbol ReadRxBuff_8721D_ROM = 0xbba1;
define exported symbol PHY_InitBBRFRegDef_8721D = 0xbbc5;
define exported symbol CheckBBRWIsStable_8721D = 0xbbf1;
define exported symbol PHY_QueryBBReg_8721D = 0xbc45;
define exported symbol PHY_SetBBReg_8721D = 0xbc9d;
define exported symbol PHY_RFSerialRead_8721D = 0xbcf9;
define exported symbol PHY_RFSerialWrite_8721D = 0xbd8d;
define exported symbol PHY_QueryRFReg_8721D = 0xbda9;
define exported symbol PHY_SetRFReg_8721D = 0xbdb1;
define exported symbol SetSmartPSTimer_8721D_ROM = 0xbdb9;
define exported symbol SetPwrStateReg_8721D_ROM = 0xbe15;
define exported symbol ResetPSParm_8721D_ROM = 0xbe89;
define exported symbol ChkTxQueueIsEmpty_8721D_ROM = 0xbec5;
define exported symbol Legacy_PS_Setting_8721D_ROM = 0xbee9;
define exported symbol PSModeSetting_8721D_ROM = 0xbf61;
define exported symbol ConfigListenBeaconPeriod_8721D_ROM = 0xbff5;
define exported symbol PSSetMode_8721D_ROM = 0xc035;
define exported symbol PS_S2ToS3State_8721D_ROM = 0xc085;
define exported symbol PS_S2ToS0State_8721D_ROM = 0xc109;
define exported symbol PS_S3ToS2orS0State_8721D_ROM = 0xc139;
define exported symbol PS_S0ToS1State_8721D_ROM = 0xc1a1;
define exported symbol PS_S1ToS0orS2State_8721D_ROM = 0xc229;
define exported symbol PS_S2ToS4State_8721D_ROM = 0xc299;
define exported symbol PS_S2ToS5State_8721D_ROM = 0xc2ed;
define exported symbol PS_S5ToS2State_8721D_ROM = 0xc329;
define exported symbol PS_S4ToS2State_8721D_ROM = 0xc365;
define exported symbol SmartPS2InitTimerAndToGetRxPkt_8721D_ROM = 0xc3a1;
define exported symbol SetBcnEarlyAndTimeout_8721D_ROM = 0xc3e9;
define exported symbol EnlargeBcnEarlyAndTimeout_8721D_ROM = 0xc48d;
define exported symbol ResetBcnEarlyAdjustParm_8721D_ROM = 0xc4e1;
define exported symbol PS_S0ToS6State_8721D_ROM = 0xc51d;
define exported symbol PS_S6ToS0State_8721D_ROM = 0xc555;
define exported symbol Set_arfr_8721D_ROM = 0xc58d;
define exported symbol InitRAInfo_8721D_ROM = 0xc5e9;
define exported symbol C2H_RA_Rpt_8721D_ROM = 0xc735;
define exported symbol check_rate_8721D_ROM = 0xc76d;
define exported symbol RateUp_search_RateMask_8721D_ROM = 0xc795;
define exported symbol RateDown_search_RateMask_8721D_ROM = 0xc7cd;
define exported symbol RateDownTrying_8721D_ROM = 0xc825;
define exported symbol Count_Ratio_8721D_ROM = 0xc899;
define exported symbol ArfrRefresh_8721D_ROM = 0xc907;
define exported symbol H2CHDL_Set_MACID_Config_8721D_ROM = 0xca89;
define exported symbol H2CHDL_SetRssiSingle_8721D_ROM = 0xcb85;
define exported symbol ODM_H2C_RADebugMonitor_8721D_ROM = 0xcbb5;
define exported symbol C2H_RA_Dbg_code_en_8721D_ROM = 0xcc99;
define exported symbol InitialRateByRssi_8721D_ROM = 0xcd01;
define exported symbol H2CHDL_Set_FW_Trace_en_8721D_ROM = 0xcd71;
define exported symbol H2CHDL_APReqTxrpt_8721D_ROM = 0xcdad;
define exported symbol H2CHDL_InitRateCollect_8721D_ROM = 0xcf15;
define exported symbol Pkt_Num_shift_8721D_ROM = 0xcf7d;
define exported symbol PT_update_8721D_ROM = 0xcf95;
define exported symbol ResetTxrpt_8721D_ROM = 0xcfad;
define exported symbol PsuseTxrpt_8721D_ROM = 0xcfe5;
define exported symbol GetTxrptStatistic_8721D_ROM = 0xcff9;
define exported symbol PollingReg_8721D_ROM = 0xd0e1;
define exported symbol WritePONReg_8721D_ROM = 0xd121;
define exported symbol ReadPONReg_8721D_ROM = 0xd12d;
define exported symbol InitGTimer32us_8721D_ROM = 0xd13d;
define exported symbol InitGTimer1ms_8721D_ROM = 0xd17d;
define exported symbol setwlanimr_8721D_ROM = 0xd1d1;
define exported symbol clrwlanimr_8721D_ROM = 0xd1ed;
define exported symbol setwlanimr2_8721D_ROM = 0xd209;
define exported symbol clrwlanimr2_8721D_ROM = 0xd225;
define exported symbol setftimr_8721D_ROM = 0xd241;
define exported symbol clrftimr_8721D_ROM = 0xd25d;
define exported symbol GetIV = 0xd279;
define exported symbol GetIVLenAndSecurityType_8721D_ROM = 0xd2a5;
define exported symbol GetMACHeaderLen_8721D_ROM = 0xd2e9;
define exported symbol UpdateIV_8721D_ROM = 0xd309;
define exported symbol ROM_SIM_ENABLE = 0x20000;
define exported symbol SPIC_CALIB_PATTERN = 0x20064;
define exported symbol PORT_AB = 0x20080;
define exported symbol OTF_IV_ENC = 0x20088;
define exported symbol ROM_IMG1_VALID_PATTEN = 0x20098;
define exported symbol BAUDRATE_TABLE = 0x2013c;
define exported symbol FWLBK_LEN = 0x201cc;
define exported symbol FWLBK_TXDESC = 0x201d4;
define exported symbol FWLBK_HEADER_UC = 0x201fc;
define exported symbol FWLBK_HEADER = 0x20214;
define exported symbol CAM_DATA0 = 0x2022c;
define exported symbol CAM_DATA1 = 0x20240;
define exported symbol CAM_DATA2 = 0x20244;
define exported symbol CAM_TYPE = 0x20258;
define exported symbol CAM_DATA2_WAPI = 0x2025d;
define exported symbol FWLBK_DATARATE = 0x20261;
define exported symbol Const_Zero = 0x2026c;
define exported symbol Const_Rb = 0x2027c;
define exported symbol aes_rcon = 0x2028c;
define exported symbol aes_sbox_enc = 0x202b8;
define exported symbol aes_mul_2 = 0x203b8;
define exported symbol aes_mul_3 = 0x204b8;
define exported symbol __rom_bss_start__ = 0x80000;
define exported symbol NewVectorTable = 0x80000;
define exported symbol UserIrqFunTable = 0x800c0;
define exported symbol UserIrqDataTable = 0x80140;
define exported symbol ConfigDebugClose = 0x801c0;
define exported symbol ConfigDebugBuffer = 0x801c4;
define exported symbol ConfigDebugBufferGet = 0x801c8;
define exported symbol ConfigDebug = 0x801cc;
define exported symbol rand_first = 0x801dc;
define exported symbol rand_seed = 0x801e0;
define exported symbol RBSS_UDELAY_DIV = 0x801f4;
define exported symbol flash_init_para = 0x801f8;
define exported symbol GDMA_Reg = 0x80258;
define exported symbol PortA_IrqHandler = 0x8025c;
define exported symbol PortA_IrqData = 0x802dc;
define exported symbol PortB_IrqHandler = 0x8035c;
define exported symbol PortB_IrqData = 0x803dc;
define exported symbol IPC_IrqHandler = 0x8045c;
define exported symbol IPC_IrqData = 0x804dc;
define exported symbol IS_FPGA_VERIF = 0x8055c;
define exported symbol NEW_CALIBREATION_END = 0x80560;
define exported symbol shell_argv_array = 0x80568;
define exported symbol shell_ctl = 0x805a8;
define exported symbol shell_recv_all_data_onetime = 0x805cc;
define exported symbol shell_buf = 0x805d0;
define exported symbol xmodem_ctrl = 0x80654;
define exported symbol xmodem_uartx = 0x80660;
define exported symbol mpu_entry_register = 0x80664;
define exported symbol FWLBK_CTL_H = 0x8066c;
define exported symbol FWLBK_SeqNum = 0x8066e;
define exported symbol FWLBK_CTL_L = 0x80670;
define exported symbol FWLBK_CTL_EXT = 0x80671;
define exported symbol FwlbkModeAFElbk_8721D_PTR = 0x80674;
define exported symbol FwlbkModeSecTest_8721D_PTR = 0x80678;
define exported symbol FwlbkModeMaclbk_8721D_PTR = 0x8067c;
define exported symbol FwlbkModeTx_8721D_PTR = 0x80680;
define exported symbol FwlbkModeTxNoCheck_8721D_PTR = 0x80684;
define exported symbol FwlbkMcuPollMgq_8721D_PTR = 0x80688;
define exported symbol FwlbkUpdateParam_8721D_PTR = 0x8068c;
define exported symbol FwlbkSetCAM_8721D_PTR = 0x80690;
define exported symbol FwlbkCheckRxPayload_8721D_PTR = 0x80694;
define exported symbol FwlbkModeSel_8721D_PTR = 0x80698;
define exported symbol FwlbkPreparePkt_8721D_PTR = 0x8069c;
define exported symbol FwlbkMode_8721D_PTR = 0x806a0;
define exported symbol FwlbkHWInitialLLT_8721D_PTR = 0x806a4;
define exported symbol FwlbkLLTWrite_8721D_PTR = 0x806a8;
define exported symbol FwlbkDbgPrtU16_8721D_PTR = 0x806ac;
define exported symbol AES_Encrypt_1W_8721D_PTR = 0x806b0;
define exported symbol AES_CMAC_1W_8721D_PTR = 0x806b4;
define exported symbol AES_CMAC_GenerateSubKey_1W_8721D_PTR = 0x806b8;
define exported symbol AES_KeyExpansion_1W_8721D_PTR = 0x806bc;
define exported symbol AESDecrypt128_8721D_PTR = 0x806c0;
define exported symbol AESEncrypt128_8721D_PTR = 0x806c4;
define exported symbol FillMichaelPacketInfo_8721D_PTR = 0x806c8;
define exported symbol FillParameterIpsec_8721D_PTR = 0x806cc;
define exported symbol Aes128DecIpsec_8721D_PTR = 0x806d0;
define exported symbol Aes128EncIpsec_8721D_PTR = 0x806d4;
define exported symbol TkipMicIpsec_8721D_PTR = 0x806d8;
define exported symbol RC4Ipsec_8721D_PTR = 0x806dc;
define exported symbol HmcMd5Ipsec_8721D_PTR = 0x806e0;
define exported symbol HmacSha1Ipsec_8721D_PTR = 0x806e4;
define exported symbol AESUnwrapSwap_8721D_PTR = 0x806e8;
define exported symbol AesUnwrapIpsec_8721D_PTR = 0x806ec;
define exported symbol IPSecSetDescAddr_8721D_PTR = 0x806f0;
define exported symbol IPSecSetExMemoryAddr_8721D_PTR = 0x806f4;
define exported symbol IPSecEngine_8721D_PTR = 0x806f8;
define exported symbol IPSecSetOPMode_8721D_PTR = 0x806fc;
define exported symbol IPSecGetDataIOMode_8721D_PTR = 0x80700;
define exported symbol IPSecWriteDataIOMode_8721D_PTR = 0x80704;
define exported symbol IPSecDesrciptor_8721D_PTR = 0x80708;
define exported symbol IPSWriteDescriptorIO_8721D_PTR = 0x8070c;
define exported symbol IPSecFillDesrciptor_8721D_PTR = 0x80710;
define exported symbol IPSecDataOut_8721D_PTR = 0x80714;
define exported symbol IPSecDataIn_8721D_PTR = 0x80718;
define exported symbol getCheckSum_8721D_PTR = 0x8071c;
define exported symbol getSumValue_8721D_PTR = 0x80720;
define exported symbol AssignKeyRscToIV_Ptr = 0x80724;
define exported symbol AssignIvToKeyRsc_Ptr = 0x80728;
define exported symbol WepIvCheck_Ptr = 0x8072c;
define exported symbol AesTkipIvCheck_Ptr = 0x80730;
define exported symbol RTmemcmpBackward_Ptr = 0x80734;
define exported symbol AppendTkipMIC_Ptr = 0x80738;
define exported symbol ReadGTKData_Ptr = 0x8073c;
define exported symbol ReadCAM_Ptr = 0x80740;
define exported symbol WriteCAM_Ptr = 0x80744;
define exported symbol write_cam_wow_Ptr = 0x80748;
define exported symbol wpa_supplicant_send_2_of_2_Ptr = 0x8074c;
define exported symbol wpa_supplicant_decrypt_key_data_Ptr = 0x80750;
define exported symbol wpa_supplicant_process_1_of_2_Ptr = 0x80754;
define exported symbol OnWpa_offload_Ptr = 0x80758;
define exported symbol WepIvFun_Ptr = 0x8075c;
define exported symbol AesTkipIvFun_Ptr = 0x80760;
define exported symbol GetIVLenAndSecurityType_Ptr = 0x80764;
define exported symbol GetMACHeaderLen_Ptr = 0x80768;
define exported symbol updateCheckSumVer2_Ptr = 0x8076c;
define exported symbol UpdateIV_Ptr = 0x80770;
define exported symbol WakeUpHost_Ptr = 0x80774;
define exported symbol PollingReg_8721D_Ptr = 0x80778;
define exported symbol InitGTimer1ms_Ptr = 0x8077c;
define exported symbol InitGTimer32us_Ptr = 0x80780;
define exported symbol IssueRsvdPagePacketSetting_Ptr = 0x80784;
define exported symbol ResetBcnEarlyAdjustParm_Ptr = 0x80788;
define exported symbol EnlargeBcnEarlyAndTimeout_Ptr = 0x8078c;
define exported symbol SetBcnEarlyAndTimeout_Ptr = 0x80790;
define exported symbol PS_S2ToS0State_Ptr = 0x80794;
define exported symbol ConfigListenBeaconPeriod_Ptr = 0x80798;
define exported symbol IssueNullData_Ptr = 0x8079c;
define exported symbol ChangeTransmiteRate_Ptr = 0x807a0;
define exported symbol PowerBitSetting_Ptr = 0x807a4;
define exported symbol IssueQNull_Ptr = 0x807a8;
define exported symbol ReadRxBuff_Ptr = 0x807ac;
define exported symbol IssuePSPoll_Ptr = 0x807b0;
define exported symbol ChkandChangePS_Ptr = 0x807b4;
define exported symbol IssueCTS2Self_Ptr = 0x807b8;
define exported symbol WriteTxPauseWithMask_Ptr = 0x807bc;
define exported symbol WriteTxPause_Ptr = 0x807c0;
define exported symbol WaitTxStateMachineOk_Ptr = 0x807c4;
define exported symbol PS_S4_Condition_Match_Ptr = 0x807c8;
define exported symbol PS_S2_Condition_Match_Ptr = 0x807cc;
define exported symbol PsCloseRF_Ptr = 0x807d0;
define exported symbol PsOpenRF_Ptr = 0x807d4;
define exported symbol PSModeSetting_Ptr = 0x807d8;
define exported symbol Legacy_PS_Setting_Ptr = 0x807dc;
define exported symbol ResetPSParm_Ptr = 0x807e0;
define exported symbol Change_PS_State_Ptr = 0x807e4;
define exported symbol SetPwrStateReg_Ptr = 0x807e8;
define exported symbol SetSmartPSTimer_Ptr = 0x807ec;
define exported symbol C2HBTInfo_Ptr = 0x807f0;
define exported symbol BT_TDMA_Slot_Operation_0and3_Ptr = 0x807f4;
define exported symbol FlexibleExtensionDecision_Ptr = 0x807f8;
define exported symbol BTRoleChangeDefaultSetting_Ptr = 0x807fc;
define exported symbol BTNullSetting_Ptr = 0x80800;
define exported symbol MailboxINTHDL_Patch_Ptr = 0x80804;
define exported symbol MailboxINTHDL_Ptr = 0x80808;
define exported symbol BTypeTDMATimeOuthdl_Ptr = 0x8080c;
define exported symbol DacSwing_Ptr = 0x80810;
define exported symbol IssueBTQNull_Ptr = 0x80814;
define exported symbol BTRoleChangeTBTTHDL_Ptr = 0x80818;
define exported symbol BTypeTDMATBTThdl_Ptr = 0x8081c;
define exported symbol BackupAntennaSetting_Ptr = 0x80820;
define exported symbol C2HBTLoopback_Ptr = 0x80824;
define exported symbol BTMailboxRetry_Ptr = 0x80828;
define exported symbol InitBTMailbox_Ptr = 0x8082c;
define exported symbol BTypeTDMABCNEarly_Ptr = 0x80830;
define exported symbol InitBTypeTDMA2_Ptr = 0x80834;
define exported symbol BTRoleChangeTimerHDL_Ptr = 0x80838;
define exported symbol C2HBTMpRpt_Ptr = 0x8083c;
define exported symbol ChangeCoexTable_Ptr = 0x80840;
define exported symbol WlanActCtrl_Ptr = 0x80844;
define exported symbol InitBTCoexTimer_Ptr = 0x80848;
define exported symbol AOAC_ANT_SWT_Ptr = 0x8084c;
define exported symbol BT_TDMA_Slot_Operation_2and5_Ptr = 0x80850;
define exported symbol BT_TDMA_Slot_Operation_1and4_Ptr = 0x80854;
define exported symbol FillMailbox_Ptr = 0x80858;
define exported symbol WL2BTMailbox_Ptr = 0x8085c;
define exported symbol Write778_Ptr = 0x80860;
define exported symbol PktBufAccessCtrl_Ptr = 0x80864;
define exported symbol H2CDeQueue_Ptr = 0x80868;
define exported symbol H2CInQueue_Ptr = 0x8086c;
define exported symbol C2HPKTRxDESC_Ptr = 0x80870;
define exported symbol FillC2HContant_Ptr = 0x80874;
define exported symbol IssueC2HPKT_Ptr = 0x80878;
define exported symbol C2HDeQueue_Ptr = 0x8087c;
define exported symbol C2HInQueue_Ptr = 0x80880;
define exported symbol H2CCmdFunc_Ptr = 0x80884;
define exported symbol ODM_H2C_RADebugMonitor_Ptr = 0x80888;
define exported symbol ArfrRefresh_Ptr = 0x8088c;
define exported symbol RateUp_search_RateMask_Ptr = 0x80890;
define exported symbol check_rate_Ptr = 0x80894;
define exported symbol Set_arfr_Ptr = 0x80898;
define exported symbol InitialRateByRssi_Ptr = 0x8089c;
define exported symbol InitRAInfo_rsvd_Ptr = 0x808a0;
define exported symbol InitialRateUpdate_Ptr = 0x808a4;
define exported symbol ISRSendSignalCommon_Ptr = 0x808a8;
define exported symbol OSSendSignalCommon_Ptr = 0x808ac;
define exported symbol pRATE_UP_FAIL_WAITING = 0x808b0;
define exported symbol pARFB_table = 0x808b4;
define exported symbol pRA = 0x808b8;
define exported symbol pDEBUG = 0x808bc;
define exported symbol pstainfo_ra = 0x808c0;
define exported symbol pODM = 0x80900;
define exported symbol pAOACPage1 = 0x80904;
define exported symbol pAOACGlobalInfo = 0x80908;
define exported symbol pNetworkListInfo = 0x8090c;
define exported symbol pRWV2 = 0x80910;
define exported symbol pteredo_info = 0x80914;
define exported symbol pAOACReport = 0x80918;
define exported symbol pSecurityInfo = 0x8091c;
define exported symbol pIpv6PseudoHeaderInfo = 0x80920;
define exported symbol pNDPInfo = 0x80924;
define exported symbol pARPInfo = 0x8092c;
define exported symbol pAOACInfo = 0x80930;
define exported symbol BTcnt = 0x80934;
define exported symbol BTDebugEN = 0x8095c;
define exported symbol pBT_Init_Info = 0x80960;
define exported symbol pBT_Page_Scan_Interval = 0x80964;
define exported symbol pWIFI_Info = 0x80968;
define exported symbol pBtParm = 0x8096c;
define exported symbol pBTTxStatus = 0x80970;
define exported symbol pBtTdmaParm = 0x80974;
define exported symbol pMediaStatus = 0x80978;
define exported symbol ScanEn = 0x8097c;
define exported symbol pPSBTParm = 0x80980;
define exported symbol pPSTParm = 0x80984;
define exported symbol pPSParm = 0x80988;
define exported symbol pP2PPSInfo = 0x8098c;
define exported symbol pHwParm = 0x80990;
define exported symbol pMichaelPktParm = 0x80994;
define exported symbol pMsgKeyParm = 0x80998;
define exported symbol pOpModeParm = 0x8099c;
define exported symbol pDataCtrlParm = 0x809a0;
define exported symbol pIpSec = 0x809a4;
define exported symbol RXFF0_BNDY = 0x809a8;
define exported symbol pC2HEvt = 0x809ac;
define exported symbol pH2CEvt = 0x809b0;
define exported symbol pRPL = 0x809b4;
define exported symbol pIntHdl = 0x809b8;
define exported symbol TaskBitMap = 0x809bc;
define exported symbol PHYRegDef = 0x809be;
define exported symbol __rom_bss_end__ = 0x809ce;

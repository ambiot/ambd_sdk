define exported symbol __rom_bss_start__ = 0x10000000;
define exported symbol ConfigDebugClose = 0x10000000;
define exported symbol ConfigDebugBuffer = 0x10000004;
define exported symbol ConfigDebugBufferGet = 0x10000008;
define exported symbol ConfigDebug = 0x1000000c;
define exported symbol rand_first = 0x1000001c;
define exported symbol rand_seed = 0x10000020;
define exported symbol RBSS_UDELAY_DIV = 0x10000034;
define exported symbol flash_init_para = 0x10000038;
define exported symbol GDMA_Reg = 0x10000098;
define exported symbol PortA_IrqHandler = 0x1000009c;
define exported symbol PortA_IrqData = 0x1000011c;
define exported symbol PortB_IrqHandler = 0x1000019c;
define exported symbol PortB_IrqData = 0x1000021c;
define exported symbol IPC_IrqHandler = 0x1000029c;
define exported symbol IPC_IrqData = 0x1000031c;
define exported symbol IS_FPGA_VERIF = 0x1000039c;
define exported symbol crypto_engine = 0x100003a0;
define exported symbol __rom_bss_end__ = 0x10000564;
define exported symbol __rom_bss_start_s__ = 0x1007c000;
define exported symbol NewVectorTable = 0x1007c000;
define exported symbol UserIrqFunTable = 0x1007c140;
define exported symbol UserIrqDataTable = 0x1007c240;
define exported symbol mpu_entry_register = 0x1007c340;
define exported symbol __rom_bss_end_s__ = 0x1007c348;
define exported symbol __ram_start_table_start__ = 0x1007d000;
define exported symbol STACK_TOP = 0x1007effc;
define exported symbol __vectors_table = 0x10100000;
define exported symbol Reset_Handler = 0x10100101;
define exported symbol NMI_Handler = 0x10100111;
define exported symbol HardFault_Handler = 0x10100115;
define exported symbol MemManage_Handler = 0x10100119;
define exported symbol BusFault_Handler = 0x1010011d;
define exported symbol UsageFault_Handler = 0x10100121;
define exported symbol SecureFault_Handler = 0x10100125;
define exported symbol DiagVSprintf = 0x1010012d;
define exported symbol DiagPrintf = 0x101003f5;
define exported symbol DiagPrintfD = 0x10100445;
define exported symbol DiagSPrintf = 0x10100471;
define exported symbol DiagSnPrintf = 0x1010049d;
define exported symbol Rand = 0x10100765;
define exported symbol Rand_Arc4 = 0x101007f1;
define exported symbol RandBytes_Get = 0x10100825;
define exported symbol io_assert_failed = 0x10100871;
define exported symbol BKUP_Write = 0x10100891;
define exported symbol BKUP_Read = 0x101008b5;
define exported symbol BKUP_Set = 0x101008d5;
define exported symbol BKUP_Clear = 0x101008fd;
define exported symbol BOOT_Reason = 0x10100929;
define exported symbol DelayNop = 0x10100939;
define exported symbol DelayUs = 0x10100949;
define exported symbol DelayMs = 0x10100995;
define exported symbol EFUSEPowerSwitch = 0x101009a9;
define exported symbol EFUSERead8 = 0x10100a31;
define exported symbol EFUSEWrite8 = 0x10100b1d;
define exported symbol EFUSE_PG_Packet = 0x10100c21;
define exported symbol EFUSE_LogicalMap_Read = 0x10100e99;
define exported symbol EFUSE_LogicalMap_Write = 0x10100fad;
define exported symbol FLASH_RxData = 0x10101195;
define exported symbol FLASH_TxCmd = 0x1010129d;
define exported symbol FLASH_SW_CS_Control = 0x10101329;
define exported symbol FLASH_SetSpiMode = 0x1010137d;
define exported symbol FLASH_RxCmd = 0x10101415;
define exported symbol FLASH_WaitBusy = 0x10101479;
define exported symbol FLASH_WriteEn = 0x101014f9;
define exported symbol FLASH_TxData256B = 0x1010151d;
define exported symbol FLASH_TxData12B = 0x1010160d;
define exported symbol FLASH_SetStatus = 0x101016ed;
define exported symbol FLASH_Erase = 0x1010170d;
define exported symbol FLASH_DeepPowerDown = 0x101017b9;
define exported symbol FLASH_SetStatusBits = 0x10101809;
define exported symbol FLASH_StructInit_Micron = 0x101018dd;
define exported symbol FLASH_StructInit_MXIC = 0x1010198d;
define exported symbol FLASH_StructInit_GD = 0x10101a39;
define exported symbol FLASH_StructInit = 0x10101aed;
define exported symbol FLASH_Init = 0x10101ba1;
define exported symbol GDMA_StructInit = 0x10101c25;
define exported symbol GDMA_SetLLP = 0x10101c45;
define exported symbol GDMA_ClearINTPendingBit = 0x10101cd9;
define exported symbol GDMA_ClearINT = 0x10101da5;
define exported symbol GDMA_INTConfig = 0x10101e75;
define exported symbol GDMA_Cmd = 0x10101f91;
define exported symbol GDMA_Init = 0x10101ff9;
define exported symbol GDMA_ChCleanAutoReload = 0x1010214d;
define exported symbol GDMA_SetSrcAddr = 0x101021d1;
define exported symbol GDMA_GetSrcAddr = 0x10102221;
define exported symbol GDMA_GetDstAddr = 0x1010226d;
define exported symbol GDMA_SetDstAddr = 0x101022b9;
define exported symbol GDMA_SetBlkSize = 0x10102309;
define exported symbol GDMA_GetBlkSize = 0x10102369;
define exported symbol GDMA_ChnlRegister = 0x101023b9;
define exported symbol GDMA_ChnlUnRegister = 0x10102401;
define exported symbol GDMA_ChnlAlloc = 0x1010243d;
define exported symbol GDMA_ChnlFree = 0x101024d9;
define exported symbol GDMA_GetIrqNum = 0x10102565;
define exported symbol GPIO_INTMode = 0x101025a9;
define exported symbol GPIO_INTConfig = 0x10102641;
define exported symbol GPIO_INTHandler = 0x10102679;
define exported symbol GPIO_Direction = 0x10102721;
define exported symbol GPIO_Init = 0x10102755;
define exported symbol GPIO_DeInit = 0x101027e1;
define exported symbol GPIO_ReadDataBit = 0x1010284d;
define exported symbol GPIO_WriteBit = 0x10102871;
define exported symbol GPIO_PortDirection = 0x101028a1;
define exported symbol GPIO_PortRead = 0x101028c5;
define exported symbol GPIO_PortWrite = 0x101028d5;
define exported symbol GPIO_UserRegIrq = 0x101028ed;
define exported symbol IPC_INTConfig = 0x10102925;
define exported symbol IPC_IERSet = 0x10102939;
define exported symbol IPC_IERGet = 0x1010293d;
define exported symbol IPC_INTRequest = 0x10102941;
define exported symbol IPC_INTClear = 0x1010294d;
define exported symbol IPC_INTGet = 0x10102959;
define exported symbol IPC_CPUID = 0x1010295d;
define exported symbol IPC_SEMGet = 0x10102969;
define exported symbol IPC_SEMFree = 0x101029b9;
define exported symbol IPC_INTHandler = 0x10102a21;
define exported symbol IPC_INTUserHandler = 0x10102a61;
define exported symbol LOGUART_StructInit = 0x10102a9d;
define exported symbol LOGUART_Init = 0x10102ab5;
define exported symbol LOGUART_PutChar = 0x10102af5;
define exported symbol LOGUART_GetChar = 0x10102b29;
define exported symbol LOGUART_Readable = 0x10102b45;
define exported symbol LOGUART_GetIMR = 0x10102b59;
define exported symbol LOGUART_SetIMR = 0x10102b65;
define exported symbol LOGUART_WaitBusy = 0x10102b71;
define exported symbol LOGUART_SetBaud = 0x10102b91;
define exported symbol mpu_enable = 0x10102bd5;
define exported symbol mpu_disable = 0x10102bed;
define exported symbol mpu_init = 0x10102c01;
define exported symbol mpu_set_mem_attr = 0x10102c3d;
define exported symbol mpu_region_cfg = 0x10102cb1;
define exported symbol mpu_entry_free = 0x10102db5;
define exported symbol mpu_entry_alloc = 0x10102dc1;
define exported symbol RSIP_Cmd = 0x10102de9;
define exported symbol RSIP_OTF_init = 0x10102e05;
define exported symbol RSIP_OTF_Cmd = 0x10102e6d;
define exported symbol RSIP_OTF_Mask = 0x10102e81;
define exported symbol RSIP_KEY_Request = 0x10102ec9;
define exported symbol RSIP_MMU_Config = 0x10102f0d;
define exported symbol RSIP_MMU_Cmd = 0x10102f31;
define exported symbol PAD_DrvStrength = 0x10102f51;
define exported symbol PAD_PullCtrl = 0x10102f6d;
define exported symbol PAD_CMD = 0x10102f99;
define exported symbol Pinmux_Config = 0x10102fb9;
define exported symbol Pinmux_ConfigGet = 0x10102fd9;
define exported symbol Pinmux_UartLogCtrl = 0x10102fe9;
define exported symbol Pinmux_SpicCtrl = 0x1010303d;
define exported symbol simulation_bit_index = 0x10103181;
define exported symbol simulation_stage_set = 0x10103199;
define exported symbol SYSTIMER_Init = 0x101031c5;
define exported symbol SYSTIMER_TickGet = 0x10103215;
define exported symbol SYSTIMER_GetPassTime = 0x10103225;
define exported symbol RTIM_TimeBaseStructInit = 0x10103255;
define exported symbol RTIM_Cmd = 0x1010326d;
define exported symbol RTIM_GetCount = 0x101032f5;
define exported symbol RTIM_INTConfig = 0x10103361;
define exported symbol RTIM_INTClear = 0x101033f1;
define exported symbol RTIM_TimeBaseInit = 0x1010345d;
define exported symbol RTIM_DeInit = 0x10103595;
define exported symbol RTIM_INTClearPendingBit = 0x10103611;
define exported symbol RTIM_GetFlagStatus = 0x10103685;
define exported symbol RTIM_GetINTStatus = 0x1010375d;
define exported symbol UART_DeInit = 0x1010383d;
define exported symbol UART_StructInit = 0x10103845;
define exported symbol UART_BaudParaGetFull = 0x10103861;
define exported symbol UART_BaudParaGet = 0x10103899;
define exported symbol UART_SetBaud = 0x101038bd;
define exported symbol UART_SetBaudExt = 0x10103955;
define exported symbol UART_SetRxLevel = 0x101039cd;
define exported symbol UART_RxCmd = 0x101039f5;
define exported symbol UART_Writable = 0x10103a09;
define exported symbol UART_Readable = 0x10103a11;
define exported symbol UART_CharPut = 0x10103a19;
define exported symbol UART_CharGet = 0x10103a1d;
define exported symbol UART_ReceiveData = 0x10103a25;
define exported symbol UART_SendData = 0x10103a4d;
define exported symbol UART_ReceiveDataTO = 0x10103a75;
define exported symbol UART_SendDataTO = 0x10103ab5;
define exported symbol UART_RxByteCntClear = 0x10103af5;
define exported symbol UART_RxByteCntGet = 0x10103b01;
define exported symbol UART_BreakCtl = 0x10103b09;
define exported symbol UART_ClearRxFifo = 0x10103b1d;
define exported symbol UART_Init = 0x10103b3d;
define exported symbol UART_ClearTxFifo = 0x10103be5;
define exported symbol UART_INTConfig = 0x10103bf1;
define exported symbol UART_IntStatus = 0x10103c01;
define exported symbol UART_ModemStatusGet = 0x10103c05;
define exported symbol UART_LineStatusGet = 0x10103c09;
define exported symbol UART_WaitBusy = 0x10103c0d;
define exported symbol BOOT_ROM_SignatureCheck = 0x101041a9;
define exported symbol BOOT_ROM_FromFlash = 0x10104281;
define exported symbol BOOT_ROM_InitDebugFlg = 0x1010438d;
define exported symbol BOOT_ROM_ResetVsr = 0x101043a9;
define exported symbol EXT32K_Cmd = 0x101044c9;
define exported symbol XTAL_ClkGet = 0x101044e9;
define exported symbol CPU_ClkSet = 0x10104501;
define exported symbol CPU_ClkGet = 0x10104515;
define exported symbol RCC_PeriphClockCmd = 0x10106021;
define exported symbol RCC_PeriphClockSource_RTC = 0x101060b9;
define exported symbol RCC_PeriphClockSource_I2C = 0x10106105;
define exported symbol RCC_PeriphClockSource_QDEC = 0x10106125;
define exported symbol RCC_PeriphClockSource_UART = 0x10106145;
define exported symbol SYSCFG_GetChipInfo = 0x101061b9;
define exported symbol INT_HardFault = 0x101061c5;
define exported symbol INT_MemManage = 0x101061e5;
define exported symbol INT_BusFault = 0x10106205;
define exported symbol INT_UsageFault = 0x10106225;
define exported symbol INT_SecureFault = 0x10106245;
define exported symbol INT_HardFault_C = 0x10106265;
define exported symbol INT_NMI = 0x10106635;
define exported symbol irq_table_init = 0x1010677d;
define exported symbol irq_enable = 0x101069b9;
define exported symbol irq_disable = 0x101069d5;
define exported symbol irq_set_priority = 0x101069f9;
define exported symbol irq_get_priority = 0x10106a25;
define exported symbol irq_set_pending = 0x10106a4d;
define exported symbol irq_get_pending = 0x10106a69;
define exported symbol irq_clear_pending = 0x10106a8d;
define exported symbol irq_register = 0x10106aa9;
define exported symbol irq_unregister = 0x10106af5;
define exported symbol _char2num = 0x10106b15;
define exported symbol _2char2dec = 0x10106b45;
define exported symbol _2char2hex = 0x10106bb9;
define exported symbol _memchr = 0x10106c21;
define exported symbol _memcmp = 0x10106cb1;
define exported symbol _memcpy = 0x10106d15;
define exported symbol _memmove = 0x10106dc1;
define exported symbol _memset = 0x10106e89;
define exported symbol _vsscanf = 0x10106fe5;
define exported symbol _sscanf = 0x101075a9;
define exported symbol _stratoi = 0x101075c9;
define exported symbol _strcat = 0x1010761d;
define exported symbol _strchr = 0x1010765d;
define exported symbol _strcmp = 0x1010772d;
define exported symbol _strcpy = 0x101077a1;
define exported symbol _stricmp = 0x101077ed;
define exported symbol _strlen = 0x10107821;
define exported symbol _strncat = 0x10107885;
define exported symbol _strncmp = 0x101078e1;
define exported symbol _strncpy = 0x10107985;
define exported symbol _strnlen = 0x101079ed;
define exported symbol _strpbrk = 0x10107a21;
define exported symbol _strsep = 0x10107a4d;
define exported symbol _strstr = 0x10107d0d;
define exported symbol _strtoull = 0x10107f25;
define exported symbol _strtoll = 0x10107fe5;
define exported symbol _strtok = 0x10108005;
define exported symbol __strtok_r = 0x10108011;
define exported symbol _strtok_r = 0x10108075;
define exported symbol _strtol_r = 0x1010807d;
define exported symbol _strtol = 0x10108199;
define exported symbol _strtoul_r = 0x1010819d;
define exported symbol _strtoul = 0x101082d1;
define exported symbol _strupr = 0x101082d5;
define exported symbol __rom_entry_ns_start__ = 0x101c0000;
define exported symbol SPIC_CALIB_PATTERN = 0x101d4000;
define exported symbol PORT_AB = 0x101d401c;

define exported symbol __rom_bss_start__ = 0x10000000;
define exported symbol ConfigDebugClose = 0x10000000;
define exported symbol ConfigDebugBuffer = 0x10000004;
define exported symbol ConfigDebugBufferGet = 0x10000008;
define exported symbol ConfigDebug = 0x1000000c;
define exported symbol rand_first = 0x1000001c;
define exported symbol rand_seed = 0x10000020;
define exported symbol RBSS_UDELAY_DIV = 0x10000034;
define exported symbol flash_init_para = 0x10000038;
define exported symbol GDMA_Reg = 0x10000098;
define exported symbol PortA_IrqHandler = 0x1000009c;
define exported symbol PortA_IrqData = 0x1000011c;
define exported symbol PortB_IrqHandler = 0x1000019c;
define exported symbol PortB_IrqData = 0x1000021c;
define exported symbol IPC_IrqHandler = 0x1000029c;
define exported symbol IPC_IrqData = 0x1000031c;
define exported symbol IS_FPGA_VERIF = 0x1000039c;
define exported symbol crypto_engine = 0x100003a0;
define exported symbol __rom_bss_end__ = 0x10000564;
define exported symbol __rom_bss_start_ns__ = 0x10001000;
define exported symbol NewVectorTable = 0x10001000;
define exported symbol UserIrqFunTable = 0x10001140;
define exported symbol UserIrqDataTable = 0x10001240;
define exported symbol mpu_entry_register = 0x10001340;
define exported symbol p_rom_ssl_ram_map = 0x10001348;
define exported symbol rom_ssl_ram_map = 0x1000134c;
define exported symbol __rom_bss_end_ns__ = 0x1000138c;
define exported symbol __rom_bss_start_s__ = 0x1007c000;
define exported symbol __ram_start_table_start__ = 0x1007d000;
define exported symbol STACK_TOP = 0x1007effc;
define exported symbol __vectors_table = 0x1010a000;
define exported symbol Reset_Handler = 0x1010a101;
define exported symbol NMI_Handler = 0x1010a111;
define exported symbol HardFault_Handler = 0x1010a115;
define exported symbol MemManage_Handler = 0x1010a119;
define exported symbol BusFault_Handler = 0x1010a11d;
define exported symbol UsageFault_Handler = 0x1010a121;
define exported symbol SecureFault_Handler = 0x1010a125;
define exported symbol DiagVSprintf = 0x1010a12d;
define exported symbol DiagPrintf = 0x1010a3f5;
define exported symbol DiagPrintfD = 0x1010a445;
define exported symbol DiagSPrintf = 0x1010a471;
define exported symbol DiagSnPrintf = 0x1010a49d;
define exported symbol Rand = 0x1010a765;
define exported symbol Rand_Arc4 = 0x1010a7f1;
define exported symbol RandBytes_Get = 0x1010a825;
define exported symbol io_assert_failed = 0x1010a871;
define exported symbol BKUP_Write = 0x1010a891;
define exported symbol BKUP_Read = 0x1010a8b5;
define exported symbol BKUP_Set = 0x1010a8d5;
define exported symbol BKUP_Clear = 0x1010a8fd;
define exported symbol BOOT_Reason = 0x1010a929;
define exported symbol DelayNop = 0x1010a939;
define exported symbol DelayUs = 0x1010a949;
define exported symbol DelayMs = 0x1010a995;
define exported symbol EFUSEPowerSwitch = 0x1010a9a9;
define exported symbol EFUSERead8 = 0x1010aa31;
define exported symbol EFUSEWrite8 = 0x1010ab1d;
define exported symbol EFUSE_PG_Packet = 0x1010ac21;
define exported symbol EFUSE_LogicalMap_Read = 0x1010ae99;
define exported symbol EFUSE_LogicalMap_Write = 0x1010afad;
define exported symbol FLASH_RxData = 0x1010b195;
define exported symbol FLASH_TxCmd = 0x1010b29d;
define exported symbol FLASH_SW_CS_Control = 0x1010b329;
define exported symbol FLASH_SetSpiMode = 0x1010b37d;
define exported symbol FLASH_RxCmd = 0x1010b415;
define exported symbol FLASH_WaitBusy = 0x1010b479;
define exported symbol FLASH_WriteEn = 0x1010b4f9;
define exported symbol FLASH_TxData256B = 0x1010b51d;
define exported symbol FLASH_TxData12B = 0x1010b60d;
define exported symbol FLASH_SetStatus = 0x1010b6ed;
define exported symbol FLASH_Erase = 0x1010b70d;
define exported symbol FLASH_DeepPowerDown = 0x1010b7b9;
define exported symbol FLASH_SetStatusBits = 0x1010b809;
define exported symbol FLASH_StructInit_Micron = 0x1010b8dd;
define exported symbol FLASH_StructInit_MXIC = 0x1010b98d;
define exported symbol FLASH_StructInit_GD = 0x1010ba39;
define exported symbol FLASH_StructInit = 0x1010baed;
define exported symbol FLASH_Init = 0x1010bba1;
define exported symbol GDMA_StructInit = 0x1010bc25;
define exported symbol GDMA_SetLLP = 0x1010bc45;
define exported symbol GDMA_ClearINTPendingBit = 0x1010bcd9;
define exported symbol GDMA_ClearINT = 0x1010bda5;
define exported symbol GDMA_INTConfig = 0x1010be75;
define exported symbol GDMA_Cmd = 0x1010bf91;
define exported symbol GDMA_Init = 0x1010bff9;
define exported symbol GDMA_ChCleanAutoReload = 0x1010c14d;
define exported symbol GDMA_SetSrcAddr = 0x1010c1d1;
define exported symbol GDMA_GetSrcAddr = 0x1010c221;
define exported symbol GDMA_GetDstAddr = 0x1010c26d;
define exported symbol GDMA_SetDstAddr = 0x1010c2b9;
define exported symbol GDMA_SetBlkSize = 0x1010c309;
define exported symbol GDMA_GetBlkSize = 0x1010c369;
define exported symbol GDMA_ChnlRegister = 0x1010c3b9;
define exported symbol GDMA_ChnlUnRegister = 0x1010c401;
define exported symbol GDMA_ChnlAlloc = 0x1010c43d;
define exported symbol GDMA_ChnlFree = 0x1010c4d9;
define exported symbol GDMA_GetIrqNum = 0x1010c565;
define exported symbol GPIO_INTMode = 0x1010c5a9;
define exported symbol GPIO_INTConfig = 0x1010c641;
define exported symbol GPIO_INTHandler = 0x1010c679;
define exported symbol GPIO_Direction = 0x1010c721;
define exported symbol GPIO_Init = 0x1010c755;
define exported symbol GPIO_DeInit = 0x1010c7e1;
define exported symbol GPIO_ReadDataBit = 0x1010c84d;
define exported symbol GPIO_WriteBit = 0x1010c871;
define exported symbol GPIO_PortDirection = 0x1010c8a1;
define exported symbol GPIO_PortRead = 0x1010c8c5;
define exported symbol GPIO_PortWrite = 0x1010c8d5;
define exported symbol GPIO_UserRegIrq = 0x1010c8ed;
define exported symbol IPC_INTConfig = 0x1010c925;
define exported symbol IPC_IERSet = 0x1010c939;
define exported symbol IPC_IERGet = 0x1010c93d;
define exported symbol IPC_INTRequest = 0x1010c941;
define exported symbol IPC_INTClear = 0x1010c94d;
define exported symbol IPC_INTGet = 0x1010c959;
define exported symbol IPC_CPUID = 0x1010c95d;
define exported symbol IPC_SEMGet = 0x1010c969;
define exported symbol IPC_SEMFree = 0x1010c9b9;
define exported symbol IPC_INTHandler = 0x1010ca21;
define exported symbol IPC_INTUserHandler = 0x1010ca61;
define exported symbol LOGUART_StructInit = 0x1010ca9d;
define exported symbol LOGUART_Init = 0x1010cab5;
define exported symbol LOGUART_PutChar = 0x1010caf5;
define exported symbol LOGUART_GetChar = 0x1010cb29;
define exported symbol LOGUART_Readable = 0x1010cb45;
define exported symbol LOGUART_GetIMR = 0x1010cb59;
define exported symbol LOGUART_SetIMR = 0x1010cb65;
define exported symbol LOGUART_WaitBusy = 0x1010cb71;
define exported symbol LOGUART_SetBaud = 0x1010cb91;
define exported symbol mpu_enable = 0x1010cbd5;
define exported symbol mpu_disable = 0x1010cbed;
define exported symbol mpu_init = 0x1010cc01;
define exported symbol mpu_set_mem_attr = 0x1010cc3d;
define exported symbol mpu_region_cfg = 0x1010ccb1;
define exported symbol mpu_entry_free = 0x1010cdb5;
define exported symbol mpu_entry_alloc = 0x1010cdc1;
define exported symbol RSIP_Cmd = 0x1010cde9;
define exported symbol RSIP_OTF_init = 0x1010ce05;
define exported symbol RSIP_OTF_Cmd = 0x1010ce6d;
define exported symbol RSIP_OTF_Mask = 0x1010ce81;
define exported symbol RSIP_KEY_Request = 0x1010cec9;
define exported symbol RSIP_MMU_Config = 0x1010cf0d;
define exported symbol RSIP_MMU_Cmd = 0x1010cf31;
define exported symbol PAD_DrvStrength = 0x1010cf51;
define exported symbol PAD_PullCtrl = 0x1010cf6d;
define exported symbol PAD_CMD = 0x1010cf99;
define exported symbol Pinmux_Config = 0x1010cfb9;
define exported symbol Pinmux_ConfigGet = 0x1010cfd9;
define exported symbol Pinmux_UartLogCtrl = 0x1010cfe9;
define exported symbol Pinmux_SpicCtrl = 0x1010d03d;
define exported symbol simulation_bit_index = 0x1010d181;
define exported symbol simulation_stage_set = 0x1010d199;
define exported symbol SYSTIMER_Init = 0x1010d1c5;
define exported symbol SYSTIMER_TickGet = 0x1010d215;
define exported symbol SYSTIMER_GetPassTime = 0x1010d225;
define exported symbol RTIM_TimeBaseStructInit = 0x1010d255;
define exported symbol RTIM_Cmd = 0x1010d26d;
define exported symbol RTIM_GetCount = 0x1010d2f5;
define exported symbol RTIM_INTConfig = 0x1010d361;
define exported symbol RTIM_INTClear = 0x1010d3f1;
define exported symbol RTIM_TimeBaseInit = 0x1010d45d;
define exported symbol RTIM_DeInit = 0x1010d595;
define exported symbol RTIM_INTClearPendingBit = 0x1010d611;
define exported symbol RTIM_GetFlagStatus = 0x1010d685;
define exported symbol RTIM_GetINTStatus = 0x1010d75d;
define exported symbol UART_DeInit = 0x1010d83d;
define exported symbol UART_StructInit = 0x1010d845;
define exported symbol UART_BaudParaGetFull = 0x1010d861;
define exported symbol UART_BaudParaGet = 0x1010d899;
define exported symbol UART_SetBaud = 0x1010d8bd;
define exported symbol UART_SetBaudExt = 0x1010d955;
define exported symbol UART_SetRxLevel = 0x1010d9cd;
define exported symbol UART_RxCmd = 0x1010d9f5;
define exported symbol UART_Writable = 0x1010da09;
define exported symbol UART_Readable = 0x1010da11;
define exported symbol UART_CharPut = 0x1010da19;
define exported symbol UART_CharGet = 0x1010da1d;
define exported symbol UART_ReceiveData = 0x1010da25;
define exported symbol UART_SendData = 0x1010da4d;
define exported symbol UART_ReceiveDataTO = 0x1010da75;
define exported symbol UART_SendDataTO = 0x1010dab5;
define exported symbol UART_RxByteCntClear = 0x1010daf5;
define exported symbol UART_RxByteCntGet = 0x1010db01;
define exported symbol UART_BreakCtl = 0x1010db09;
define exported symbol UART_ClearRxFifo = 0x1010db1d;
define exported symbol UART_Init = 0x1010db3d;
define exported symbol UART_ClearTxFifo = 0x1010dbe5;
define exported symbol UART_INTConfig = 0x1010dbf1;
define exported symbol UART_IntStatus = 0x1010dc01;
define exported symbol UART_ModemStatusGet = 0x1010dc05;
define exported symbol UART_LineStatusGet = 0x1010dc09;
define exported symbol UART_WaitBusy = 0x1010dc0d;
define exported symbol BOOT_ROM_SignatureCheck = 0x1010e1a9;
define exported symbol BOOT_ROM_FromFlash = 0x1010e281;
define exported symbol BOOT_ROM_InitDebugFlg = 0x1010e38d;
define exported symbol BOOT_ROM_ResetVsr = 0x1010e3a9;
define exported symbol EXT32K_Cmd = 0x1010e4c9;
define exported symbol XTAL_ClkGet = 0x1010e4e9;
define exported symbol CPU_ClkSet = 0x1010e501;
define exported symbol CPU_ClkGet = 0x1010e515;
define exported symbol clear_ns_rom_bss = 0x10110021;
define exported symbol RCC_PeriphClockCmd = 0x10110039;
define exported symbol RCC_PeriphClockSource_RTC = 0x101100d1;
define exported symbol RCC_PeriphClockSource_I2C = 0x1011011d;
define exported symbol RCC_PeriphClockSource_QDEC = 0x1011013d;
define exported symbol RCC_PeriphClockSource_UART = 0x1011015d;
define exported symbol SYSCFG_GetChipInfo = 0x101101d1;
define exported symbol INT_HardFault = 0x101101dd;
define exported symbol INT_MemManage = 0x101101fd;
define exported symbol INT_BusFault = 0x1011021d;
define exported symbol INT_UsageFault = 0x1011023d;
define exported symbol INT_SecureFault = 0x1011025d;
define exported symbol INT_HardFault_C = 0x1011027d;
define exported symbol INT_NMI = 0x1011064d;
define exported symbol irq_table_init = 0x10110795;
define exported symbol irq_enable = 0x101109d1;
define exported symbol irq_disable = 0x101109ed;
define exported symbol irq_set_priority = 0x10110a11;
define exported symbol irq_get_priority = 0x10110a3d;
define exported symbol irq_set_pending = 0x10110a65;
define exported symbol irq_get_pending = 0x10110a81;
define exported symbol irq_clear_pending = 0x10110aa5;
define exported symbol irq_register = 0x10110ac1;
define exported symbol irq_unregister = 0x10110b0d;
define exported symbol _char2num = 0x10110b2d;
define exported symbol _2char2dec = 0x10110b5d;
define exported symbol _2char2hex = 0x10110bd1;
define exported symbol _memchr = 0x10110c39;
define exported symbol _memcmp = 0x10110cc9;
define exported symbol _memcpy = 0x10110d2d;
define exported symbol _memmove = 0x10110dd9;
define exported symbol _memset = 0x10110ea1;
define exported symbol _vsscanf = 0x10110ffd;
define exported symbol _sscanf = 0x101115c1;
define exported symbol _stratoi = 0x101115e1;
define exported symbol _strcat = 0x10111635;
define exported symbol _strchr = 0x10111675;
define exported symbol _strcmp = 0x10111745;
define exported symbol _strcpy = 0x101117b9;
define exported symbol _stricmp = 0x10111805;
define exported symbol _strlen = 0x10111839;
define exported symbol _strncat = 0x1011189d;
define exported symbol _strncmp = 0x101118f9;
define exported symbol _strncpy = 0x1011199d;
define exported symbol _strnlen = 0x10111a05;
define exported symbol _strpbrk = 0x10111a39;
define exported symbol _strsep = 0x10111a65;
define exported symbol _strstr = 0x10111d25;
define exported symbol _strtoull = 0x10111f3d;
define exported symbol _strtoll = 0x10111ffd;
define exported symbol _strtok = 0x1011201d;
define exported symbol __strtok_r = 0x10112029;
define exported symbol _strtok_r = 0x1011208d;
define exported symbol _strtol_r = 0x10112095;
define exported symbol _strtol = 0x101121b1;
define exported symbol _strtoul_r = 0x101121b5;
define exported symbol _strtoul = 0x101122e9;
define exported symbol _strupr = 0x101122ed;
define exported symbol CRYPTO_chacha_20 = 0x10112309;
define exported symbol rom_ed25519_gen_keypair = 0x101125c5;
define exported symbol rom_ed25519_gen_signature = 0x101125c9;
define exported symbol rom_ed25519_verify_signature = 0x101125df;
define exported symbol rom_ed25519_ge_double_scalarmult_vartime = 0x10113e89;
define exported symbol rom_ed25519_ge_frombytes_negate_vartime = 0x10114195;
define exported symbol rom_ed25519_ge_p3_tobytes = 0x10114695;
define exported symbol rom_ed25519_ge_scalarmult_base = 0x101146df;
define exported symbol rom_ed25519_ge_tobytes = 0x10114807;
define exported symbol rom_ed25519_crypto_sign_seed_keypair = 0x10114851;
define exported symbol rom_ed25519_crypto_sign_verify_detached = 0x101148a9;
define exported symbol rom_ed25519_sc_muladd = 0x10114ad5;
define exported symbol rom_ed25519_sc_reduce = 0x1011b265;
define exported symbol rom_ed25519_crypto_sign_detached = 0x1011c6dd;
define exported symbol CRYPTO_poly1305_init = 0x1011ca99;
define exported symbol CRYPTO_poly1305_update = 0x1011cb31;
define exported symbol CRYPTO_poly1305_finish = 0x1011cba7;
define exported symbol rom_sha512_starts = 0x1011cd4d;
define exported symbol rom_sha512_update = 0x1011cd51;
define exported symbol rom_sha512_finish = 0x1011cd55;
define exported symbol rom_sha512 = 0x1011cd59;
define exported symbol rom_sha512_hmac_starts = 0x1011cd5d;
define exported symbol rom_sha512_hmac_update = 0x1011cdf1;
define exported symbol rom_sha512_hmac_finish = 0x1011cdf5;
define exported symbol rom_sha512_hmac_reset = 0x1011ce49;
define exported symbol rom_sha512_hmac = 0x1011ce65;
define exported symbol rom_sha512_hkdf = 0x1011cea1;
define exported symbol curve25519_donna = 0x1011dce5;
define exported symbol mbedtls_aes_init = 0x1011e569;
define exported symbol mbedtls_aes_free = 0x1011e579;
define exported symbol mbedtls_aes_setkey_enc = 0x1011e58d;
define exported symbol mbedtls_aes_setkey_dec = 0x1011e7a5;
define exported symbol mbedtls_aes_encrypt = 0x1011e8c1;
define exported symbol mbedtls_aes_decrypt = 0x1011ecf9;
define exported symbol mbedtls_aes_crypt_ecb = 0x1011f145;
define exported symbol mbedtls_aes_crypt_cbc = 0x1011f1c9;
define exported symbol mbedtls_aes_crypt_cfb128 = 0x1011f3d5;
define exported symbol mbedtls_aes_crypt_cfb8 = 0x1011f44b;
define exported symbol mbedtls_aes_crypt_ctr = 0x1011f4b1;
define exported symbol mbedtls_arc4_init = 0x1011f515;
define exported symbol mbedtls_arc4_free = 0x1011f525;
define exported symbol mbedtls_arc4_setup = 0x1011f539;
define exported symbol mbedtls_arc4_crypt = 0x1011f57f;
define exported symbol mbedtls_asn1_get_len = 0x1011f5c5;
define exported symbol mbedtls_asn1_get_tag = 0x1011f661;
define exported symbol mbedtls_asn1_get_bool = 0x1011f689;
define exported symbol mbedtls_asn1_get_int = 0x1011f6b9;
define exported symbol mbedtls_asn1_get_mpi = 0x1011f6ff;
define exported symbol mbedtls_asn1_get_bitstring = 0x1011f725;
define exported symbol mbedtls_asn1_get_bitstring_null = 0x1011f76d;
define exported symbol mbedtls_asn1_get_sequence_of = 0x1011f795;
define exported symbol mbedtls_asn1_get_alg = 0x1011f81d;
define exported symbol mbedtls_asn1_get_alg_null = 0x1011f8a9;
define exported symbol mbedtls_asn1_free_named_data = 0x1011f8ed;
define exported symbol mbedtls_asn1_free_named_data_list = 0x1011f91d;
define exported symbol mbedtls_asn1_find_named_data = 0x1011f941;
define exported symbol mbedtls_asn1_write_len = 0x1011f96d;
define exported symbol mbedtls_asn1_write_tag = 0x1011fa55;
define exported symbol mbedtls_asn1_write_raw_buffer = 0x1011fa71;
define exported symbol mbedtls_asn1_write_mpi = 0x1011faa1;
define exported symbol mbedtls_asn1_write_null = 0x1011fb13;
define exported symbol mbedtls_asn1_write_oid = 0x1011fb39;
define exported symbol mbedtls_asn1_write_algorithm_identifier = 0x1011fb6d;
define exported symbol mbedtls_asn1_write_bool = 0x1011fbbd;
define exported symbol mbedtls_asn1_write_int = 0x1011fbff;
define exported symbol mbedtls_asn1_write_printable_string = 0x1011fc61;
define exported symbol mbedtls_asn1_write_ia5_string = 0x1011fc95;
define exported symbol mbedtls_asn1_write_bitstring = 0x1011fcc9;
define exported symbol mbedtls_asn1_write_octet_string = 0x1011fd3d;
define exported symbol mbedtls_asn1_store_named_data = 0x1011fd71;
define exported symbol mbedtls_base64_encode = 0x1011fe29;
define exported symbol mbedtls_base64_decode = 0x1011ff2d;
define exported symbol mbedtls_mpi_init = 0x10120b19;
define exported symbol mbedtls_mpi_free = 0x10120b27;
define exported symbol mbedtls_mpi_grow = 0x10120b5d;
define exported symbol mbedtls_mpi_shrink = 0x10120bc1;
define exported symbol mbedtls_mpi_copy = 0x10120c41;
define exported symbol mbedtls_mpi_swap = 0x10120c9d;
define exported symbol mbedtls_mpi_safe_cond_assign = 0x10120cc5;
define exported symbol mbedtls_mpi_safe_cond_swap = 0x10120d31;
define exported symbol mbedtls_mpi_lset = 0x10120db3;
define exported symbol mbedtls_mpi_get_bit = 0x10120df1;
define exported symbol mbedtls_mpi_set_bit = 0x10120e11;
define exported symbol mbedtls_mpi_lsb = 0x10120e61;
define exported symbol mbedtls_mpi_bitlen = 0x10120e93;
define exported symbol mbedtls_mpi_size = 0x10120ed3;
define exported symbol mbedtls_mpi_read_binary = 0x10120edf;
define exported symbol mbedtls_mpi_write_binary = 0x10120f47;
define exported symbol mbedtls_mpi_shift_l = 0x10120f91;
define exported symbol mbedtls_mpi_shift_r = 0x1012102d;
define exported symbol mbedtls_mpi_cmp_abs = 0x101210ab;
define exported symbol mbedtls_mpi_cmp_mpi = 0x101211ed;
define exported symbol mbedtls_mpi_cmp_int = 0x10121277;
define exported symbol mbedtls_mpi_add_abs = 0x101212a3;
define exported symbol mbedtls_mpi_sub_abs = 0x10121357;
define exported symbol mbedtls_mpi_add_mpi = 0x101213d5;
define exported symbol mbedtls_mpi_sub_mpi = 0x10121417;
define exported symbol mbedtls_mpi_add_int = 0x1012145b;
define exported symbol mbedtls_mpi_sub_int = 0x10121487;
define exported symbol mbedtls_mpi_mul_mpi = 0x101214b3;
define exported symbol mbedtls_mpi_mul_int = 0x1012158f;
define exported symbol mbedtls_mpi_read_string = 0x101215a9;
define exported symbol mbedtls_mpi_div_mpi = 0x101216c9;
define exported symbol mbedtls_mpi_div_int = 0x10121aeb;
define exported symbol mbedtls_mpi_mod_mpi = 0x10121b15;
define exported symbol mbedtls_mpi_mod_int = 0x10121b75;
define exported symbol mbedtls_mpi_write_string = 0x10121c15;
define exported symbol mbedtls_mpi_exp_mod = 0x10121d6d;
define exported symbol mbedtls_mpi_gcd = 0x101221a5;
define exported symbol mbedtls_mpi_fill_random = 0x101222af;
define exported symbol mbedtls_mpi_inv_mod = 0x101224f9;
define exported symbol mbedtls_mpi_is_prime = 0x101227b5;
define exported symbol mbedtls_mpi_gen_prime = 0x10122809;
define exported symbol mbedtls_ctr_drbg_init = 0x10122ae9;
define exported symbol mbedtls_ctr_drbg_free = 0x10122af9;
define exported symbol mbedtls_ctr_drbg_set_prediction_resistance = 0x10122b17;
define exported symbol mbedtls_ctr_drbg_set_entropy_len = 0x10122b1b;
define exported symbol mbedtls_ctr_drbg_set_reseed_interval = 0x10122b1f;
define exported symbol mbedtls_ctr_drbg_update = 0x10122b23;
define exported symbol mbedtls_ctr_drbg_reseed = 0x10122b47;
define exported symbol mbedtls_ctr_drbg_seed_entropy_len = 0x10122bc5;
define exported symbol mbedtls_ctr_drbg_seed = 0x10122c19;
define exported symbol mbedtls_ctr_drbg_random_with_add = 0x10122c2b;
define exported symbol mbedtls_ctr_drbg_random = 0x10122cf1;
define exported symbol mbedtls_des_init = 0x10122d11;
define exported symbol mbedtls_des_free = 0x10122d1d;
define exported symbol mbedtls_des3_init = 0x10122d25;
define exported symbol mbedtls_des3_free = 0x10122d35;
define exported symbol mbedtls_des_key_set_parity = 0x10122d3f;
define exported symbol mbedtls_des_key_check_key_parity = 0x10122d59;
define exported symbol mbedtls_des_key_check_weak = 0x10122d7d;
define exported symbol mbedtls_des_setkey = 0x10122da9;
define exported symbol mbedtls_des_setkey_enc = 0x101231bb;
define exported symbol mbedtls_des_setkey_dec = 0x101231e5;
define exported symbol mbedtls_des3_set2key_enc = 0x10123239;
define exported symbol mbedtls_des3_set2key_dec = 0x1012327d;
define exported symbol mbedtls_des3_set3key_enc = 0x101232c1;
define exported symbol mbedtls_des3_set3key_dec = 0x101232fd;
define exported symbol mbedtls_des_crypt_ecb = 0x10123339;
define exported symbol mbedtls_des_crypt_cbc = 0x10123541;
define exported symbol mbedtls_des3_crypt_ecb = 0x10123731;
define exported symbol mbedtls_des3_crypt_cbc = 0x10123b81;
define exported symbol mbedtls_dhm_init = 0x10123e01;
define exported symbol mbedtls_dhm_read_params = 0x10123e0d;
define exported symbol mbedtls_dhm_make_params = 0x10123e59;
define exported symbol mbedtls_dhm_read_public = 0x10123f91;
define exported symbol mbedtls_dhm_make_public = 0x10123fb5;
define exported symbol mbedtls_dhm_calc_secret = 0x1012406d;
define exported symbol mbedtls_dhm_free = 0x1012426d;
define exported symbol mbedtls_dhm_parse_dhm = 0x101242cf;
define exported symbol mbedtls_ecdh_gen_public = 0x101243c1;
define exported symbol mbedtls_ecdh_compute_shared = 0x101243c5;
define exported symbol mbedtls_ecdh_init = 0x10124425;
define exported symbol mbedtls_ecdh_free = 0x10124435;
define exported symbol mbedtls_ecdh_make_params = 0x1012447d;
define exported symbol mbedtls_ecdh_read_params = 0x101244ed;
define exported symbol mbedtls_ecdh_get_params = 0x10124515;
define exported symbol mbedtls_ecdh_make_public = 0x10124561;
define exported symbol mbedtls_ecdh_read_public = 0x101245b1;
define exported symbol mbedtls_ecdh_calc_secret = 0x101245dd;
define exported symbol mbedtls_ecdsa_sign = 0x10124693;
define exported symbol mbedtls_ecdsa_sign_det = 0x10124815;
define exported symbol mbedtls_ecdsa_verify = 0x101248bd;
define exported symbol mbedtls_ecdsa_write_signature = 0x101249f9;
define exported symbol mbedtls_ecdsa_write_signature_det = 0x10124a9d;
define exported symbol mbedtls_ecdsa_read_signature = 0x10124abb;
define exported symbol mbedtls_ecdsa_genkey = 0x10124b55;
define exported symbol mbedtls_ecdsa_from_keypair = 0x10124b83;
define exported symbol mbedtls_ecdsa_init = 0x10124bbb;
define exported symbol mbedtls_ecdsa_free = 0x10124bbf;
define exported symbol mbedtls_ecjpake_init = 0x10124ff5;
define exported symbol mbedtls_ecjpake_free = 0x1012504f;
define exported symbol mbedtls_ecjpake_setup = 0x101250a5;
define exported symbol mbedtls_ecjpake_check = 0x101250e9;
define exported symbol mbedtls_ecjpake_read_round_one = 0x10125109;
define exported symbol mbedtls_ecjpake_write_round_one = 0x10125185;
define exported symbol mbedtls_ecjpake_read_round_two = 0x101252ad;
define exported symbol mbedtls_ecjpake_write_round_two = 0x10125365;
define exported symbol mbedtls_ecjpake_derive_secret = 0x101254a1;
define exported symbol mbedtls_ecp_curve_list = 0x10125de9;
define exported symbol mbedtls_ecp_curve_info_from_grp_id = 0x10125df1;
define exported symbol mbedtls_ecp_curve_info_from_tls_id = 0x10125e0d;
define exported symbol mbedtls_ecp_curve_info_from_name = 0x10125e29;
define exported symbol mbedtls_ecp_point_init = 0x10125e51;
define exported symbol mbedtls_ecp_group_init = 0x10125e71;
define exported symbol mbedtls_ecp_keypair_init = 0x10125e81;
define exported symbol mbedtls_ecp_point_free = 0x10125ea1;
define exported symbol mbedtls_ecp_group_free = 0x10125ec1;
define exported symbol mbedtls_ecp_keypair_free = 0x10125f31;
define exported symbol mbedtls_ecp_copy = 0x10125f51;
define exported symbol mbedtls_ecp_group_copy = 0x10125f7d;
define exported symbol mbedtls_ecp_set_zero = 0x10125f83;
define exported symbol mbedtls_ecp_is_zero = 0x10126839;
define exported symbol mbedtls_ecp_point_cmp = 0x1012684b;
define exported symbol mbedtls_ecp_point_read_string = 0x1012687d;
define exported symbol mbedtls_ecp_point_write_binary = 0x101268a9;
define exported symbol mbedtls_ecp_point_read_binary = 0x1012694d;
define exported symbol mbedtls_ecp_tls_read_point = 0x101269b9;
define exported symbol mbedtls_ecp_tls_write_point = 0x101269e9;
define exported symbol mbedtls_ecp_tls_read_group = 0x10126a19;
define exported symbol mbedtls_ecp_tls_write_group = 0x10126a61;
define exported symbol mbedtls_ecp_check_pubkey = 0x10126a99;
define exported symbol mbedtls_ecp_check_privkey = 0x10126c2d;
define exported symbol mbedtls_ecp_mul = 0x10126c9d;
define exported symbol mbedtls_ecp_muladd = 0x1012726f;
define exported symbol mbedtls_ecp_gen_keypair_base = 0x101272d9;
define exported symbol mbedtls_ecp_gen_keypair = 0x101273d9;
define exported symbol mbedtls_ecp_gen_key = 0x101273f1;
define exported symbol mbedtls_ecp_check_pub_priv = 0x10127419;
define exported symbol mbedtls_ecp_group_load = 0x10128519;
define exported symbol mbedtls_hmac_drbg_init = 0x1012893d;
define exported symbol mbedtls_hmac_drbg_update = 0x10128949;
define exported symbol mbedtls_hmac_drbg_seed_buf = 0x101289e5;
define exported symbol mbedtls_hmac_drbg_reseed = 0x10128a35;
define exported symbol mbedtls_hmac_drbg_seed = 0x10128aad;
define exported symbol mbedtls_hmac_drbg_set_prediction_resistance = 0x10128b1d;
define exported symbol mbedtls_hmac_drbg_set_entropy_len = 0x10128b21;
define exported symbol mbedtls_hmac_drbg_set_reseed_interval = 0x10128b25;
define exported symbol mbedtls_hmac_drbg_random_with_add = 0x10128b29;
define exported symbol mbedtls_hmac_drbg_random = 0x10128bdd;
define exported symbol mbedtls_hmac_drbg_free = 0x10128bed;
define exported symbol mbedtls_md_list = 0x10128c09;
define exported symbol mbedtls_md_info_from_string = 0x10128c11;
define exported symbol mbedtls_md_info_from_type = 0x10128ca9;
define exported symbol mbedtls_md_init = 0x10128ced;
define exported symbol mbedtls_md_free = 0x10128cf9;
define exported symbol mbedtls_md_clone = 0x10128d45;
define exported symbol mbedtls_md_setup = 0x10128d6d;
define exported symbol mbedtls_md_init_ctx = 0x10128db5;
define exported symbol mbedtls_md_starts = 0x10128dbb;
define exported symbol mbedtls_md_update = 0x10128dd5;
define exported symbol mbedtls_md_finish = 0x10128df1;
define exported symbol mbedtls_md = 0x10128e0d;
define exported symbol mbedtls_md_hmac_starts = 0x10128e29;
define exported symbol mbedtls_md_hmac_update = 0x10128eed;
define exported symbol mbedtls_md_hmac_finish = 0x10128f0d;
define exported symbol mbedtls_md_hmac_reset = 0x10128f65;
define exported symbol mbedtls_md_hmac = 0x10128f91;
define exported symbol mbedtls_md_process = 0x10128fe5;
define exported symbol mbedtls_md_get_size = 0x10129001;
define exported symbol mbedtls_md_get_type = 0x10129009;
define exported symbol mbedtls_md_get_name = 0x1012900f;
define exported symbol mbedtls_md5_init = 0x1012917d;
define exported symbol mbedtls_md5_free = 0x10129189;
define exported symbol mbedtls_md5_clone = 0x1012919d;
define exported symbol mbedtls_md5_starts = 0x101291a9;
define exported symbol mbedtls_md5_process = 0x101291d5;
define exported symbol mbedtls_md5_update = 0x101298dd;
define exported symbol mbedtls_md5_finish = 0x101298e3;
define exported symbol mbedtls_md5 = 0x10129995;
define exported symbol mbedtls_oid_get_attr_short_name = 0x101299fd;
define exported symbol mbedtls_oid_get_x509_ext_type = 0x10129a35;
define exported symbol mbedtls_oid_get_extended_key_usage = 0x10129a6d;
define exported symbol mbedtls_oid_get_sig_alg_desc = 0x10129aa5;
define exported symbol mbedtls_oid_get_sig_alg = 0x10129abd;
define exported symbol mbedtls_oid_get_oid_by_sig_alg = 0x10129adb;
define exported symbol mbedtls_oid_get_pk_alg = 0x10129b09;
define exported symbol mbedtls_oid_get_oid_by_pk_alg = 0x10129b41;
define exported symbol mbedtls_oid_get_ec_grp = 0x10129b69;
define exported symbol mbedtls_oid_get_oid_by_ec_grp = 0x10129ba1;
define exported symbol mbedtls_oid_get_cipher_alg = 0x10129bc9;
define exported symbol mbedtls_oid_get_md_alg = 0x10129c01;
define exported symbol mbedtls_oid_get_oid_by_md = 0x10129c39;
define exported symbol mbedtls_oid_get_pkcs12_pbe_alg = 0x10129c61;
define exported symbol mbedtls_pem_init = 0x10129e5f;
define exported symbol mbedtls_pem_read_buffer = 0x10129e6d;
define exported symbol mbedtls_pem_free = 0x1012a161;
define exported symbol mbedtls_pem_write_buffer = 0x1012a185;
define exported symbol mbedtls_pk_init = 0x1012a279;
define exported symbol mbedtls_pk_free = 0x1012a283;
define exported symbol mbedtls_pk_info_from_type = 0x1012a2a5;
define exported symbol mbedtls_pk_setup = 0x1012a2d9;
define exported symbol mbedtls_pk_setup_rsa_alt = 0x1012a305;
define exported symbol mbedtls_pk_can_do = 0x1012a351;
define exported symbol mbedtls_pk_verify = 0x1012a361;
define exported symbol mbedtls_pk_sign = 0x1012a3bd;
define exported symbol mbedtls_pk_decrypt = 0x1012a425;
define exported symbol mbedtls_pk_encrypt = 0x1012a451;
define exported symbol mbedtls_pk_check_pair = 0x1012a47d;
define exported symbol mbedtls_pk_get_bitlen = 0x1012a4bd;
define exported symbol mbedtls_pk_verify_ext = 0x1012a4cd;
define exported symbol mbedtls_pk_debug = 0x1012a585;
define exported symbol mbedtls_pk_get_name = 0x1012a5a9;
define exported symbol mbedtls_pk_get_type = 0x1012a5bd;
define exported symbol mbedtls_pk_write_pubkey = 0x1012aa23;
define exported symbol mbedtls_pk_write_pubkey_der = 0x1012aaad;
define exported symbol mbedtls_pk_write_key_der = 0x1012ab7d;
define exported symbol mbedtls_pk_write_pubkey_pem = 0x1012ad79;
define exported symbol mbedtls_pk_write_key_pem = 0x1012adc1;
define exported symbol mbedtls_rsa_init = 0x1012aecd;
define exported symbol mbedtls_rsa_set_padding = 0x1012aeed;
define exported symbol mbedtls_rsa_check_pubkey = 0x1012aef7;
define exported symbol mbedtls_rsa_check_privkey = 0x1012af4d;
define exported symbol mbedtls_rsa_check_pub_priv = 0x1012b169;
define exported symbol mbedtls_rsa_public = 0x1012b1a1;
define exported symbol mbedtls_rsa_private = 0x1012b20f;
define exported symbol mbedtls_rsa_rsaes_oaep_encrypt = 0x1012b465;
define exported symbol mbedtls_rsa_rsaes_pkcs1_v15_encrypt = 0x1012b58d;
define exported symbol mbedtls_rsa_pkcs1_encrypt = 0x1012b675;
define exported symbol mbedtls_rsa_rsaes_oaep_decrypt = 0x1012b6b5;
define exported symbol mbedtls_rsa_rsaes_pkcs1_v15_decrypt = 0x1012b821;
define exported symbol mbedtls_rsa_pkcs1_decrypt = 0x1012b92d;
define exported symbol mbedtls_rsa_rsassa_pss_sign = 0x1012b975;
define exported symbol mbedtls_rsa_rsassa_pkcs1_v15_sign = 0x1012badd;
define exported symbol mbedtls_rsa_pkcs1_sign = 0x1012bc85;
define exported symbol mbedtls_rsa_rsassa_pss_verify_ext = 0x1012bcc9;
define exported symbol mbedtls_rsa_rsassa_pss_verify = 0x1012be75;
define exported symbol mbedtls_rsa_rsassa_pkcs1_v15_verify = 0x1012bea7;
define exported symbol mbedtls_rsa_pkcs1_verify = 0x1012c009;
define exported symbol mbedtls_rsa_free = 0x1012c04d;
define exported symbol mbedtls_rsa_gen_key = 0x1012c0bb;
define exported symbol mbedtls_rsa_copy = 0x1012c261;
define exported symbol mbedtls_sha1_init = 0x1012c365;
define exported symbol mbedtls_sha1_free = 0x1012c371;
define exported symbol mbedtls_sha1_clone = 0x1012c385;
define exported symbol mbedtls_sha1_starts = 0x1012c391;
define exported symbol mbedtls_sha1_process = 0x1012c3c5;
define exported symbol mbedtls_sha1_update = 0x1012d391;
define exported symbol mbedtls_sha1_finish = 0x1012d397;
define exported symbol mbedtls_sha1 = 0x1012d45d;
define exported symbol mbedtls_sha256_init = 0x1012d491;
define exported symbol mbedtls_sha256_free = 0x1012d49d;
define exported symbol mbedtls_sha256_clone = 0x1012d4b1;
define exported symbol mbedtls_sha256_starts = 0x1012d4bd;
define exported symbol mbedtls_sha256_process = 0x1012d55d;
define exported symbol mbedtls_sha256_update = 0x1012dc89;
define exported symbol mbedtls_sha256_finish = 0x1012dc8f;
define exported symbol mbedtls_sha256 = 0x1012dd91;
define exported symbol mbedtls_sha512_init = 0x1012ddc9;
define exported symbol mbedtls_sha512_free = 0x1012ddd5;
define exported symbol mbedtls_sha512_clone = 0x1012dde9;
define exported symbol mbedtls_sha512_starts = 0x1012ddf5;
define exported symbol mbedtls_sha512_process = 0x1012df29;
define exported symbol mbedtls_sha512_update = 0x1012ec7d;
define exported symbol mbedtls_sha512_finish = 0x1012ec83;
define exported symbol mbedtls_sha512 = 0x1012eeb9;
define exported symbol __rom_entry_ns_start__ = 0x101c0000;
define exported symbol rom_sec_call_ns_entry = 0x101c0000;
define exported symbol __rom_entry_ns_end__ = 0x101c0008;
define exported symbol SPIC_CALIB_PATTERN = 0x101c0008;
define exported symbol PORT_AB = 0x101c0024;
define exported symbol armBitRevIndexTable1024 = 0x101c004c;
define exported symbol twiddleCoef_1024 = 0x101c0e5c;
define exported symbol mbedtls_sha512_info = 0x101ce344;
define exported symbol mbedtls_sha384_info = 0x101ce374;
define exported symbol mbedtls_sha256_info = 0x101ce3a4;
define exported symbol mbedtls_sha224_info = 0x101ce3d4;
define exported symbol mbedtls_sha1_info = 0x101ce404;
define exported symbol mbedtls_md5_info = 0x101ce434;
define exported symbol mbedtls_rsa_alt_info = 0x101cea78;
define exported symbol mbedtls_ecdsa_info = 0x101ceaa8;
define exported symbol mbedtls_eckeydh_info = 0x101cead8;
define exported symbol mbedtls_eckey_info = 0x101ceb08;
define exported symbol mbedtls_rsa_info = 0x101ceb38;
define exported symbol __rom_bss_end_s__ = 0x200f9000;
